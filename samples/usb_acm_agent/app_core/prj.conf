## Kconfig
```
config USBD_MANUFACTURER
    string "USB device manufacturer string"
    default "Zephyr Project"
    help
      USB device manufacturer string.

config USBD_PRODUCT
    string "USB device product string"
    default "USBD"
    help
      USB device product stringa.

config USBD_PID
    hex "USB device Product ID"
    default 0x0001
    help
      USB device Product ID.

config USBD_VID
    hex "USB device Vendor ID"
    default 0x2fe3
    help
      USB device Vendor ID.

config USBD_SELF_POWERED
    bool "USB device Self-powered attribute"
    default y
    help
      Set the Self-powered attribute in the configuration.

config USBD_REMOTE_WAKEUP
    bool "USB device Remote Wakeup attribute"
    help
      Set the Remote Wakeup attribute in the configuration.

config USBD_MAX_POWER
    int "USB device bMaxPower value"
    default 125
    range 0 250
    help
      bMaxPower value in the configuration in 2 mA units.

source "Kconfig.zephyr"
```

## prj.conf
```kconfig
CONFIG_USB_DEVICE_STACK_NEXT=y
CONFIG_USBD_HID_SUPPORT=y
CONFIG_USBD_CDC_ACM_CLASS=y
CONFIG_UART_LINE_CTRL=y
CONFIG_USBD_CDC_ACM_LOG_LEVEL_ERR=y
CONFIG_LOG=y
CONFIG_USBD_LOG_LEVEL_WRN=y
CONFIG_USBD_HID_LOG_LEVEL_WRN=y
CONFIG_UDC_DRIVER_LOG_LEVEL_WRN=y
CONFIG_USBD_PID=0x0007
CONFIG_USBD_VID=0x2fe3
CONFIG_SHELL=y
CONFIG_SHELL_BACKEND_SERIAL=y
CONFIG_UDC_BUF_POOL_SIZE=2048
CONFIG_MBOX=y
```

## app.overlay
```dts
zephyr_udc0: &usb2 {
	cdc_acm_uart0:cdc_acm_uart0 {
		compatible = "zephyr,cdc-acm-uart";
	};
    status = "okay";
};

&uart_agent {
	mbox = < &mbox_consumer_vuart1 >;
	uart = < &cdc_acm_uart0 >;
    status = "okay";
};
```

## src/main.c
```c
#include <zephyr/kernel.h>
#include <zephyr/logging/log.h>

LOG_MODULE_REGISTER(main, LOG_LEVEL_INF);

int main(void)
{
    while (true) {
        LOG_INF("app core hello world!!");
        k_msleep(1000);
    }
    return 0;
}
```

## src/usb_shell.c
```c
#include <zephyr/kernel.h>
#include <zephyr/device.h>
#include <zephyr/devicetree.h>
#include <zephyr/shell/shell.h>
#include <zephyr/shell/shell_uart.h>
#include <zephyr/logging/log.h>
#include "uart_agent.h"

LOG_MODULE_REGISTER(usb_shell, LOG_LEVEL_INF);
SHELL_UART_DEFINE(cdc_shell);

SHELL_DEFINE(shell_cdc, "usb2:", &cdc_shell,
             CONFIG_SHELL_BACKEND_SERIAL_LOG_MESSAGE_QUEUE_SIZE,
             CONFIG_SHELL_BACKEND_SERIAL_LOG_MESSAGE_QUEUE_TIMEOUT,
             SHELL_FLAG_OLF_CRLF);

#define CDC_UART_NODE DT_NODELABEL(cdc_acm_uart0)
static const struct device *cdc_uart_dev = DEVICE_DT_GET(CDC_UART_NODE);

#define AGENT_NODE DT_NODELABEL(uart_agent)
static const struct device *agent_dev = DEVICE_DT_GET(AGENT_NODE);

static struct k_work switch_local_work;
static struct k_work switch_peer_work;
static bool local_shell;

static void switch_local_work_handler(struct k_work *work)
{
    if (local_shell == false) {
        local_shell = true;
        uart_agent_stop(agent_dev);
        shell_backend_uart_resume(&shell_cdc);
        shell_start(&shell_cdc);
    }
}

static void switch_peer_work_handler(struct k_work *work)
{
    /*
     * Prevent a race between shell_stop and the shell thread's
     * state_collect exit path:
     *
     *   shell thread                            workqueue (us)
     *   ────────────                            ──────────────
     *   state_collect in progress...
     *                                           suspend UART
     *                                             (stops new RX from waking
     *                                              the shell thread — no
     *                                              new state_collect can
     *                                              start)
     *                                           sleep  →  yield
     *   ... state_collect finishes ...
     *   ... back to idle (k_poll) ...
     *                                           shell_stop
     *                                             (safe: UART is quiet,
     *                                              in-flight state_collect
     *                                              has drained, nothing
     *                                              will undo INITIALIZED)
     *                                           claim UART for forwarding
     *
     * Order matters: suspend first shuts off the source of new triggers,
     * then sleep drains whatever was already in flight. Only then is
     * shell_stop guaranteed to stick.
     */
    shell_backend_uart_suspend(&shell_cdc);
    k_msleep(10);
    shell_stop(&shell_cdc);
    uart_agent_start(agent_dev);
    local_shell = false;
}

static void on_vuart_mode_set(const struct device *dev, void *user_data)
{
    k_work_submit(&switch_local_work);
}

static int cmd_uart_switch_peer(const struct shell *sh, size_t argc, char **argv)
{
    if (sh != &shell_cdc) {
        return -EINVAL;
    }
    k_work_submit(&switch_peer_work);
    return 0;
}

SHELL_CMD_REGISTER(uart_switch_sec, NULL, "Switch uart to peer core", cmd_uart_switch_peer);

static int usb_shell_init(void)
{
    static const struct shell_backend_config_flags cfg_flags =
        SHELL_DEFAULT_BACKEND_CONFIG_FLAGS;

    int ret = shell_init(&shell_cdc, cdc_uart_dev, cfg_flags, true, LOG_LEVEL_INF);
    if (ret) {
        LOG_ERR("CDC Shell init failed: %d", ret);
        return ret;
    }

    if (!device_is_ready(agent_dev)) {
        LOG_ERR("uart_agent device not ready");
        return -ENODEV;
    }

    local_shell = true;
    k_work_init(&switch_local_work, switch_local_work_handler);
    k_work_init(&switch_peer_work, switch_peer_work_handler);
    uart_agent_callback_set(agent_dev, on_vuart_mode_set, NULL);

    return 0;
}

SYS_INIT(usb_shell_init, APPLICATION, CONFIG_APPLICATION_INIT_PRIORITY);
```

## src/usbd_ctx_init.c
```c
/*
 * Copyright (c) 2023 Nordic Semiconductor ASA
 *
 * SPDX-License-Identifier: Apache-2.0
 */

#include <stdint.h>
#include <zephyr/device.h>
#include <zephyr/usb/usbd.h>
#include <zephyr/usb/bos.h>
#include <zephyr/drivers/uart.h>
#include <zephyr/logging/log.h>

LOG_MODULE_REGISTER(usb_device_init);

#define UDC_NODE DT_NODELABEL(zephyr_udc0)

USBD_DEVICE_DEFINE(usb2,
		   DEVICE_DT_GET(UDC_NODE),
		   CONFIG_USBD_VID, CONFIG_USBD_PID);
/* doc device instantiation end */

/* doc string instantiation start */
USBD_DESC_LANG_DEFINE(lang);
USBD_DESC_MANUFACTURER_DEFINE(sample_mfr, CONFIG_USBD_MANUFACTURER);
USBD_DESC_PRODUCT_DEFINE(product, CONFIG_USBD_PRODUCT);
USBD_DESC_SERIAL_NUMBER_DEFINE(sn);
/* doc string instantiation end */

USBD_DESC_CONFIG_DEFINE(fs_cfg_desc, "FS Configuration");
USBD_DESC_CONFIG_DEFINE(hs_cfg_desc, "HS Configuration");

/* doc configuration instantiation start */
static const uint8_t attributes = (IS_ENABLED(CONFIG_USBD_SELF_POWERED) ?
				   USB_SCD_SELF_POWERED : 0) |
				  (IS_ENABLED(CONFIG_USBD_REMOTE_WAKEUP) ?
				   USB_SCD_REMOTE_WAKEUP : 0);

/* Full speed configuration */
USBD_CONFIGURATION_DEFINE(fs_config,
			  attributes,
			  CONFIG_USBD_MAX_POWER, &fs_cfg_desc);

/* High speed configuration */
USBD_CONFIGURATION_DEFINE(hs_config,
			  attributes,
			  CONFIG_USBD_MAX_POWER, &hs_cfg_desc);
/* doc configuration instantiation end */

static void sample_fix_code_triple(struct usbd_context *uds_ctx,
				   const enum usbd_speed speed)
{
	/* Always use class code information from Interface Descriptors */
	if (IS_ENABLED(CONFIG_USBD_CDC_ACM_CLASS) ||
	    IS_ENABLED(CONFIG_USBD_CDC_ECM_CLASS) ||
	    IS_ENABLED(CONFIG_USBD_CDC_NCM_CLASS) ||
	    IS_ENABLED(CONFIG_USBD_AUDIO2_CLASS)) {
		/*
		 * Class with multiple interfaces have an Interface
		 * Association Descriptor available, use an appropriate triple
		 * to indicate it.
		 */
		usbd_device_set_code_triple(uds_ctx, speed,
					    USB_BCC_MISCELLANEOUS, 0x02, 0x01);
	} else {
		usbd_device_set_code_triple(uds_ctx, speed, 0, 0, 0);
	}
}

static struct usbd_context *usbd_ctx_init(usbd_msg_cb_t msg_cb)
{
	int err;

	/* doc add string descriptor start */
	err = usbd_add_descriptor(&usb2, &lang);
	if (err) {
		LOG_ERR("Failed to initialize language descriptor (%d)", err);
		return NULL;
	}

	err = usbd_add_descriptor(&usb2, &sample_mfr);
	if (err) {
		LOG_ERR("Failed to initialize manufacturer descriptor (%d)", err);
		return NULL;
	}

	err = usbd_add_descriptor(&usb2, &product);
	if (err) {
		LOG_ERR("Failed to initialize product descriptor (%d)", err);
		return NULL;
	}

	err = usbd_add_descriptor(&usb2, &sn);
	if (err) {
		LOG_ERR("Failed to initialize SN descriptor (%d)", err);
		return NULL;
	}
	/* doc add string descriptor end */

	if (usbd_caps_speed(&usb2) == USBD_SPEED_HS) {
		err = usbd_add_configuration(&usb2, USBD_SPEED_HS,
					     &hs_config);
		if (err) {
			LOG_ERR("Failed to add High-Speed configuration");
			return NULL;
		}

		err = usbd_register_all_classes(&usb2, USBD_SPEED_HS, 1);
		if (err) {
			LOG_ERR("Failed to add register classes");
			return NULL;
		}

		sample_fix_code_triple(&usb2, USBD_SPEED_HS);
	}

	/* doc configuration register start */
	err = usbd_add_configuration(&usb2, USBD_SPEED_FS,
				     &fs_config);
	if (err) {
		LOG_ERR("Failed to add Full-Speed configuration");
		return NULL;
	}
	/* doc configuration register end */

	/* doc functions register start */
	err = usbd_register_all_classes(&usb2, USBD_SPEED_FS, 1);
	if (err) {
		LOG_ERR("Failed to add register classes");
		return NULL;
	}
	/* doc functions register end */

	sample_fix_code_triple(&usb2, USBD_SPEED_FS);

	if (msg_cb != NULL) {
		/* doc device init-and-msg start */
		err = usbd_msg_register_cb(&usb2, msg_cb);
		if (err) {
			LOG_ERR("Failed to register message callback");
			return NULL;
		}
		/* doc device init-and-msg end */
	}

	/* doc device init start */
	err = usbd_init(&usb2);
	if (err) {
		LOG_ERR("Failed to initialize device support");
		return NULL;
	}
	/* doc device init end */

	return &usb2;
}

static inline void print_baudrate(const struct device *dev)
{
	uint32_t baudrate;
	int ret;

	ret = uart_line_ctrl_get(dev, UART_LINE_CTRL_BAUD_RATE, &baudrate);
	if (ret) {
		LOG_WRN("Failed to get baudrate, ret code %d", ret);
	} else {
		LOG_INF("Baudrate %u", baudrate);
	}
}

static void usbd_msg_cb(struct usbd_context *const ctx, const struct usbd_msg *msg)
{
	LOG_INF("USBD message: %s", usbd_msg_type_string(msg->type));

	if (usbd_can_detect_vbus(ctx)) {
		if (msg->type == USBD_MSG_VBUS_READY) {
			if (usbd_enable(ctx)) {
				LOG_ERR("Failed to enable device support");
			}
		}

		if (msg->type == USBD_MSG_VBUS_REMOVED) {
			if (usbd_disable(ctx)) {
				LOG_ERR("Failed to disable device support");
			}
		}
	}

	if (msg->type == USBD_MSG_CDC_ACM_LINE_CODING) {
		print_baudrate(msg->dev);
	}
}

static int usb_stack_and_device_init(void)
{
    struct usbd_context *ctx;
    int err;

    ctx = usbd_ctx_init(usbd_msg_cb);
    if (ctx == NULL) {
        LOG_ERR("Failed to initialize USB device");
        return -ENODEV;
    }

    err = usbd_enable(ctx);
    if (err) {
        LOG_ERR("Failed to enable device support");
        return err;
    }

    LOG_DBG("USB device support enabled");

    return 0;
}
SYS_INIT(usb_stack_and_device_init, POST_KERNEL, 60);
```
