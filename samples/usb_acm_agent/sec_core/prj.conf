## CMakeLists.txt
```
# SPDX-License-Identifier: Apache-2.0

cmake_minimum_required(VERSION 3.20.0)
find_package(Zephyr REQUIRED HINTS $ENV{ZEPHYR_BASE})
project(app_core)

target_include_directories(app PRIVATE src)

FILE(GLOB app_sources src/*.c)
target_sources(app PRIVATE ${app_sources})
```

## prj.conf
```kconfig
CONFIG_SHELL=y
CONFIG_LOG=y
CONFIG_LOG_MODE_IMMEDIATE=y
CONFIG_MBOX=y
CONFIG_ESPI_LPC_MBOX=y
CONFIG_BOOT_BANNER=n
CONFIG_MBOX_LOG_LEVEL_OFF=y
```

## app.overlay
```dts
&vuart1 {
    mbox = < &mbox_consumer_vuart1 >;
    status = "okay";
};
```

## src/main.c
```c
/*
 * Copyright (c) 2018 qianfan Zhao
 * Copyright (c) 2018, 2023 Nordic Semiconductor ASA
 *
 * SPDX-License-Identifier: Apache-2.0
 */

#include <zephyr/kernel.h>
#include <zephyr/logging/log.h>

LOG_MODULE_REGISTER(main, LOG_LEVEL_INF);

int main(void)
{
	while (true) {
		k_msleep(3000);
		LOG_INF("sec core hello world!!");
	}
	return 0;
}
```

## src/vuart_shell.c
```c
#include <zephyr/kernel.h>
#include <zephyr/device.h>
#include <zephyr/devicetree.h>
#include <zephyr/shell/shell.h>
#include <zephyr/shell/shell_uart.h>
#include <zephyr/logging/log.h>

LOG_MODULE_REGISTER(vuart_shell, LOG_LEVEL_INF);

SHELL_UART_DEFINE(vuart_transport);
SHELL_DEFINE(shell_vuart, "vuart:", &vuart_transport,
             CONFIG_SHELL_BACKEND_SERIAL_LOG_MESSAGE_QUEUE_SIZE,
             CONFIG_SHELL_BACKEND_SERIAL_LOG_MESSAGE_QUEUE_TIMEOUT,
             SHELL_FLAG_OLF_CRLF);

#define VUART_NODE DT_NODELABEL(vuart1)
static const struct device *vuart_dev = DEVICE_DT_GET(VUART_NODE);

static int vuart_shell_init(void)
{
    static const struct shell_backend_config_flags cfg_flags =
        SHELL_DEFAULT_BACKEND_CONFIG_FLAGS;

    if (!device_is_ready(vuart_dev)) {
        LOG_ERR("vuart device not ready");
        return -ENODEV;
    }

    int ret = shell_init(&shell_vuart, vuart_dev, cfg_flags, true, LOG_LEVEL_INF);
    if (ret) {
        LOG_ERR("VUART Shell init failed: %d", ret);
    }

    return ret;
}

SYS_INIT(vuart_shell_init, APPLICATION, CONFIG_APPLICATION_INIT_PRIORITY);
```
