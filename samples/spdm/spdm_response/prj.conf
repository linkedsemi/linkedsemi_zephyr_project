## CMakeLists.txt
```
# SPDX-License-Identifier: Apache-2.0
#
# SPDM 响应端例程。本板是 USB gadget + SPDM responder。
# 主机侧（PC 是 SPDM 请求方）在本目录执行：
#   python usb_host_tester_windows.py
#   python3 usb_host_tester_linux.py

cmake_minimum_required(VERSION 3.20.0)

# libspdm 胶水在同级 spdm_modules（不再放进 zephyr/modules）。
list(APPEND ZEPHYR_EXTRA_MODULES ${CMAKE_CURRENT_SOURCE_DIR}/../spdm_modules)

find_package(Zephyr REQUIRED HINTS $ENV{ZEPHYR_BASE})
project(mctp_spdm_usb)

include(${ZEPHYR_BASE}/samples/subsys/usb/common/common.cmake)

target_include_directories(app PRIVATE certs)
target_sources(app PRIVATE src/main.c src/spdm_secret.c)
```

## Kconfig
```
# Copyright 2026
# SPDX-License-Identifier: Apache-2.0
#
# 引入 USB sample 公共描述符（VID/PID）和 Zephyr 全局 Kconfig。

source "${ZEPHYR_BASE}/samples/subsys/usb/common/Kconfig.sample_usbd"

source "Kconfig.zephyr"
```

## sample.yaml
```
# Twister 元数据：CI 编过并在串口里等到下面这行，就算 sample 启动成功。
# 真正的 SPDM 握手要插 USB 跑主机 Python，twister 默认环境做不到。
sample:
  name: SPDM over MCTP USB Responder
common:
  tags:
    - pmci
    - mctp
    - spdm
  depends_on: usb_device
tests:
    sample.pmci.mctp.spdm_response:
    harness: console
    harness_config:
      type: one_line
      regex:
        - "SPDM over MCTP over USB"
```

## prj.conf
```kconfig
# SPDM 响应端例程的 Kconfig。请求方例程的 prj.conf 与本文件相同：
# USB / MCTP / libspdm / mbedtls 需求一样，差别只在 C 源码里的 SPDM 角色。

# USB device next：本板当 gadget，枚举成 MCTP USB class（VID 2FE3 PID 0001）。
CONFIG_USB_DEVICE_STACK_NEXT=y

# libmctp + USB binding。pkt_size 在 main.c 里改成 251，避免 USB-MCTP 单包超 255。
CONFIG_MCTP=y
CONFIG_MCTP_USB=y
# 打开 samples/spdm/spdm_modules：编入 responder_lib / requester_lib / cryptlib_mbedtls。
CONFIG_LIBSPDM=y

CONFIG_LOG=y
CONFIG_LOG_BUFFER_SIZE=4096
# USB / UDC / MCTP 驱动日志太多，压到 ERR，只留本 sample 的 INF。
CONFIG_MCTP_LOG_LEVEL_ERR=y
CONFIG_UDC_DRIVER_LOG_LEVEL_ERR=y
CONFIG_USBD_LOG_LEVEL_ERR=y

# libspdm 源码用了 C11 匿名结构体等。
CONFIG_STD_C11=y

# libspdm 上下文 + scratch + 证书链解析栈很深，默认 main 栈不够。
CONFIG_MAIN_STACK_SIZE=32768
# k_malloc：libspdm context（约几十 KB）+ scratch + mbedtls 解析证书。
CONFIG_HEAP_MEM_POOL_SIZE=196608
# ECDHE / nonce 需要随机数。没有硬件熵源时用测试发生器，量产要换成真 RNG。
CONFIG_TEST_RANDOM_GENERATOR=y
CONFIG_ENTROPY_GENERATOR=y

# 密码：Zephyr 自带 mbedtls，libspdm 的 cryptlib_mbedtls 链到这一套。
# 必须和 spdm_modules 用同一份 MBEDTLS_CONFIG_FILE，否则 GCM 上下文大小
# 不一致，FINISH 之后会 Instruction Access fault。
CONFIG_MBEDTLS=y
CONFIG_MBEDTLS_BUILTIN=y
CONFIG_MBEDTLS_ENABLE_HEAP=y
CONFIG_MBEDTLS_HEAP_SIZE=65536
# 本例程走传统 mbedtls API，不要 PSA 包装。
CONFIG_MBEDTLS_USE_PSA_CRYPTO=n

# 补 ECDSA / X509 等 libspdm 需要、Zephyr 默认没开的 mbedtls 开关。
# 文件在 samples/spdm/spdm_modules/mbedtls_user_config.h。
CONFIG_MBEDTLS_USER_CONFIG_ENABLE=y
CONFIG_MBEDTLS_USER_CONFIG_FILE="mbedtls_user_config.h"

# 部分板级启动代码用 GNU 风格的静态构造。
CONFIG_STATIC_INIT_GNU=y
```

## src/main.c
```c
/*
 * Copyright 2026
 * SPDX-License-Identifier: Apache-2.0
 *
 * @file main.c
 *
 * SPDM over MCTP over USB 响应端例程。
 *
 * 协议栈：
 *   USB 设备栈（MCTP class）
 *     -> libmctp（本端 EID = SELF_ID）
 *       -> libspdm responder（MCTP message type 0x05 / 0x06）
 *
 * 主机通过 USB 发来完整 MCTP 消息后，rx_message() 缓存请求并唤醒 main()，
 * 由 libspdm_responder_dispatch_message() 解码、处理并回送响应。
 *
 * 使用 Zephyr mbedtls（cryptlib_mbedtls）：SPDM 1.3 响应端。
 * GET_VERSION / GET_CAPABILITIES / NEGOTIATE_ALGORITHMS /
 * GET_DIGESTS（含多密钥 KeyPairID 绑定）/ GET_CERTIFICATE / CHALLENGE /
 * GET_KEY_PAIR_INFO / SET_KEY_PAIR_INFO /
 * KEY_EXCHANGE / FINISH。会话内 GET_SUPPORTED_EVENT_TYPES /
 * SUBSCRIBE_EVENT_TYPES、VENDOR_DEFINED（1111/2222）和 END_SESSION
 * 走加密通道（MCTP type 0x06）。度量尚未打开。
 */

#include <sample_usbd.h>

#include <string.h>
#include <zephyr/kernel.h>
#include <zephyr/logging/log.h>
#include <zephyr/pmci/mctp/mctp_usb.h>
#include <zephyr/usb/usbd.h>
#include <libmctp.h>

#include "industry_standard/spdm.h"
#include "industry_standard/mctp.h"
#include "library/spdm_common_lib.h"
#include "library/spdm_responder_lib.h"
#include "library/spdm_transport_mctp_lib.h"

#include "certs_generated.h"

LOG_MODULE_REGISTER(spdm_mctp, LOG_LEVEL_INF);

/** 本端 MCTP Endpoint ID。 */
#define SELF_ID      10
/** 对端（总线 owner / 主机）MCTP Endpoint ID。 */
#define BUS_OWNER_ID 20

/** libspdm 发送缓存大小，需覆盖 MCTP 头尾 + SPDM 报文。 */
#define SPDM_SENDER_BUFFER_SIZE   2048
/** libspdm 接收缓存大小，需覆盖 MCTP 头尾 + SPDM 报文。 */
#define SPDM_RECEIVER_BUFFER_SIZE 2048
/** 单条 SPDM 消息最大长度（不含传输层封装）。 */
#define SPDM_MAX_MSG_SIZE         2048

/**
 * USB 收到一帧 SPDM 后，rx_message() give，main() 的 dispatch 循环 take。
 * 初值 0：上电时还没有待处理请求。
 */
K_SEM_DEFINE(spdm_rx_sem, 0, 1);
/**
 * USB-MCTP binding 实例。子类 = Managed Device Endpoint，协议 = MCTP 1.x。
 * 真正的 pkt_size 在 main() 里改成 251（USB 单包含 4 字节头不能超过 255）。
 */
MCTP_USB_DEFINE(mctp0, USBD_MCTP_SUBCLASS_MANAGED_DEVICE_ENDPOINT, USBD_MCTP_PROTOCOL_1_X);

static struct mctp *mctp_ctx;   /**< libmctp 实例，USB 枚举完成后再创建。 */
static bool usb_configured;     /**< 已收到 USB SET_CONFIGURATION。 */

static uint8_t *spdm_context;   /**< libspdm 上下文（含 secured message 区）。 */
static uint8_t *spdm_scratch;   /**< libspdm 编解码用 scratch buffer。 */

static uint8_t sender_buf[SPDM_SENDER_BUFFER_SIZE];
static uint8_t receiver_buf[SPDM_RECEIVER_BUFFER_SIZE];
static bool sender_in_use;      /**< true = libspdm 正在 encode，未 release。 */
static bool receiver_in_use;    /**< true = libspdm 正在 decode，未 release。 */

/** 最近一帧待处理的 MCTP 载荷（含 1 字节 message type）。 */
static uint8_t pending_rx[SPDM_RECEIVER_BUFFER_SIZE];
static size_t pending_rx_len;
static uint8_t pending_eid;      /**< 请求来源 EID，回包目的地址。 */
static uint8_t pending_msg_tag;  /**< 请求 message tag，回包原样带回。 */
static bool pending_valid;

/**
 * @brief USB 设备栈消息回调：感知枚举进度。
 *
 * 必须等到 SET_CONFIGURATION 之后才初始化 MCTP / SPDM。
 * 更早发数据时主机还没认到接口，包会丢。
 *
 * @param ctx  USB 设备上下文。本例程只用消息类型，此参数未使用。
 * @param msg  USB 栈事件。关心 type == USBD_MSG_CONFIGURATION。
 *
 * @return 无。副作用：置位 usb_configured。
 */
static void sample_msg_cb(struct usbd_context *const ctx, const struct usbd_msg *msg)
{
	ARG_UNUSED(ctx);

	LOG_INF("USBD message: %s", usbd_msg_type_string(msg->type));

	if (msg->type == USBD_MSG_CONFIGURATION) {
		usb_configured = true;
	}
}

/**
 * @brief 初始化并启用 USB device next 栈（含 MCTP USB class）。
 *
 * sample_usbd_init_device() 会建描述符（VID 2FE3 PID 0001）并注册 MCTP 接口。
 * 有的控制器能检测 VBUS，插线后栈自己 enable；不能检测时要主动 usbd_enable()。
 *
 * @retval 0        成功，随后等 sample_msg_cb 报 CONFIGURATION。
 * @retval -ENODEV  sample_usbd_init_device() 失败。
 * @retval <0       usbd_enable() 返回的错误码。
 */
static int enable_usb_device_next(void)
{
	static struct usbd_context *mctp_poc_usbd;
	int err;

	mctp_poc_usbd = sample_usbd_init_device(sample_msg_cb);
	if (mctp_poc_usbd == NULL) {
		LOG_ERR("Failed to initialize USB device");
		return -ENODEV;
	}

	/* 不能检测 VBUS 的控制器不会自动上电，这里手动打开设备栈。 */
	if (!usbd_can_detect_vbus(mctp_poc_usbd)) {
		err = usbd_enable(mctp_poc_usbd);
		if (err) {
			LOG_ERR("Failed to enable device support");
			return err;
		}
	}

	LOG_INF("USB device support enabled");
	return 0;
}

/**
 * @brief libspdm 发送回调：把已封装好的传输层报文经 MCTP 发给对端。
 *
 * dispatch 处理完请求后会调用本函数。message 里已经带了 1 字节
 * MCTP type（0x05 明文 / 0x06 密文），不要再加一层。
 *
 * 响应端回包必须：
 *   - 目的 EID = 请求来源 pending_eid
 *   - message tag = 请求带来的 pending_msg_tag
 *   - tag_owner = false（tag 仍由请求方持有）
 *
 * @param context       libspdm 上下文。本例程用全局 mctp_ctx，此参数未使用。
 * @param message_size  待发送字节数，含 MCTP message type。
 * @param message       sender_buf 里 encode 好的报文。
 * @param timeout       超时（微秒）。响应端 dispatch 时为 0，本例程忽略。
 *
 * @retval LIBSPDM_STATUS_SUCCESS    已交给 mctp_message_tx()。
 * @retval LIBSPDM_STATUS_SEND_FAIL  参数非法，或 MCTP 发送失败。
 */
static libspdm_return_t spdm_device_send_message(void *context, size_t message_size,
						 const void *message, uint64_t timeout)
{
	int rc;

	ARG_UNUSED(context);
	ARG_UNUSED(timeout);

	if ((mctp_ctx == NULL) || (message == NULL) || (message_size == 0)) {
		return LIBSPDM_STATUS_SEND_FAIL;
	}

	LOG_INF("SPDM TX %u bytes to EID %u tag %u", (unsigned int)message_size, pending_eid,
		pending_msg_tag);

	/* tag_owner=false：这是对请求的应答，不能自己另起一个 tag。 */
	rc = mctp_message_tx(mctp_ctx, pending_eid, false, pending_msg_tag, (void *)message,
			     message_size);
	if (rc != 0) {
		LOG_ERR("mctp_message_tx failed: %d", rc);
		return LIBSPDM_STATUS_SEND_FAIL;
	}

	return LIBSPDM_STATUS_SUCCESS;
}

/**
 * @brief libspdm 接收回调：把 rx_message() 缓存的一帧拷入接收 buffer。
 *
 * 由 libspdm_responder_dispatch_message() 在 acquire receiver buffer 之后调用。
 * 响应端是被动的：main() 已经等信号量确认有包，这里不再阻塞。
 *
 * @param context        libspdm 上下文，本例程未使用。
 * @param message_size   入参为 buffer 容量；成功后改为实际长度。
 * @param message        入参为接收 buffer 指针（*message 指向 receiver_buf）。
 *                       载荷写到 *message 指向的内存。
 * @param timeout        超时（微秒）。响应端 dispatch 时为 0，本例程忽略。
 *
 * @retval LIBSPDM_STATUS_SUCCESS       已填充一帧，并清掉 pending_valid。
 * @retval LIBSPDM_STATUS_RECEIVE_FAIL  无待处理帧、指针为空，或长度超出 buffer。
 */
static libspdm_return_t spdm_device_receive_message(void *context, size_t *message_size,
						    void **message, uint64_t timeout)
{
	uint8_t *buf;

	ARG_UNUSED(context);
	ARG_UNUSED(timeout);

	if ((message_size == NULL) || (message == NULL) || (*message == NULL) || !pending_valid) {
		return LIBSPDM_STATUS_RECEIVE_FAIL;
	}

	buf = *message;
	if (pending_rx_len > *message_size) {
		return LIBSPDM_STATUS_RECEIVE_FAIL;
	}

	memcpy(buf, pending_rx, pending_rx_len);
	*message_size = pending_rx_len;
	/* 消费掉这一帧，避免 dispatch 再次读到同一包。 */
	pending_valid = false;

	return LIBSPDM_STATUS_SUCCESS;
}

/**
 * @brief 申请 libspdm 发送 buffer。
 *
 * encode 时占用 sender_buf，send 完成后必须 release，否则下一轮会 ACQUIRE_FAIL。
 *
 * @param context      libspdm 上下文，本例程未使用。
 * @param msg_buf_ptr  出参：成功时指向 sender_buf。
 *
 * @retval LIBSPDM_STATUS_SUCCESS      已占用发送 buffer。
 * @retval LIBSPDM_STATUS_ACQUIRE_FAIL buffer 已被占用，或 msg_buf_ptr 为空。
 */
static libspdm_return_t spdm_acquire_sender_buffer(void *context, void **msg_buf_ptr)
{
	ARG_UNUSED(context);

	if (sender_in_use || (msg_buf_ptr == NULL)) {
		return LIBSPDM_STATUS_ACQUIRE_FAIL;
	}

	sender_in_use = true;
	*msg_buf_ptr = sender_buf;
	return LIBSPDM_STATUS_SUCCESS;
}

/**
 * @brief 释放 libspdm 发送 buffer，允许下一轮 encode。
 *
 * @param context      libspdm 上下文，本例程未使用。
 * @param msg_buf_ptr  先前 acquire 得到的指针。本例程不校验是否等于 sender_buf。
 *
 * @return 无。
 */
static void spdm_release_sender_buffer(void *context, const void *msg_buf_ptr)
{
	ARG_UNUSED(context);
	ARG_UNUSED(msg_buf_ptr);
	sender_in_use = false;
}

/**
 * @brief 申请 libspdm 接收 buffer。
 *
 * decode 时占用 receiver_buf。
 *
 * @param context      libspdm 上下文，本例程未使用。
 * @param msg_buf_ptr  出参：成功时指向 receiver_buf。
 *
 * @retval LIBSPDM_STATUS_SUCCESS      已占用接收 buffer。
 * @retval LIBSPDM_STATUS_ACQUIRE_FAIL buffer 已被占用，或 msg_buf_ptr 为空。
 */
static libspdm_return_t spdm_acquire_receiver_buffer(void *context, void **msg_buf_ptr)
{
	ARG_UNUSED(context);

	if (receiver_in_use || (msg_buf_ptr == NULL)) {
		return LIBSPDM_STATUS_ACQUIRE_FAIL;
	}

	receiver_in_use = true;
	*msg_buf_ptr = receiver_buf;
	return LIBSPDM_STATUS_SUCCESS;
}

/**
 * @brief 释放 libspdm 接收 buffer。
 *
 * @param context      libspdm 上下文，本例程未使用。
 * @param msg_buf_ptr  先前 acquire 得到的指针，本例程不校验。
 *
 * @return 无。
 */
static void spdm_release_receiver_buffer(void *context, const void *msg_buf_ptr)
{
	ARG_UNUSED(context);
	ARG_UNUSED(msg_buf_ptr);
	receiver_in_use = false;
}

/**
 * @brief 填写 VENDOR_DEFINED_RESPONSE 的 StandardID / VendorID。
 *
 * 与主机约定：StandardID=0、VendorID 长度为 0，载荷自己用 ASCII 定义。
 *
 * @param context             libspdm 上下文，本例程未使用。
 * @param resp_standard_id    出参：Registry / Standard ID，本例程写 0。
 * @param resp_vendor_id_len  出参：VendorID 字节数，本例程写 0。
 * @param resp_vendor_id      VendorID 缓冲区。长度为 0 时不写，本例程未使用。
 *
 * @retval LIBSPDM_STATUS_SUCCESS            已填写。
 * @retval LIBSPDM_STATUS_INVALID_PARAMETER  出参指针为空。
 */
static libspdm_return_t spdm_vendor_get_id(void *context, uint16_t *resp_standard_id,
					   uint8_t *resp_vendor_id_len, void *resp_vendor_id)
{
	ARG_UNUSED(context);
	ARG_UNUSED(resp_vendor_id);

	if ((resp_standard_id == NULL) || (resp_vendor_id_len == NULL)) {
		return LIBSPDM_STATUS_INVALID_PARAMETER;
	}

	*resp_standard_id = 0;
	*resp_vendor_id_len = 0;
	return LIBSPDM_STATUS_SUCCESS;
}

/**
 * @brief 会话内 VENDOR_DEFINED 应用载荷：请求 "1111"，应答 "2222"。
 *
 * 只在 KEY_EX / FINISH 成功后的加密通道（MCTP type 0x06）上出现。
 * 无法识别的载荷不报错，回空响应，避免把会话拆掉。
 *
 * @param context           libspdm 上下文，本例程未使用。
 * @param req_standard_id   请求里的 StandardID，本例程不校验。
 * @param req_vendor_id_len 请求 VendorID 长度，本例程不校验。
 * @param req_vendor_id     请求 VendorID，本例程不校验。
 * @param req_size          请求载荷字节数。
 * @param req_data          请求载荷。期望 4 字节 ASCII "1111"。
 * @param resp_size         入参是应答缓冲区容量；出参是实际写入长度。
 * @param resp_data         出参：应答载荷。匹配时写 "2222"。
 *
 * @retval LIBSPDM_STATUS_SUCCESS            已填写应答（匹配或空）。
 * @retval LIBSPDM_STATUS_INVALID_PARAMETER  指针为空。
 * @retval LIBSPDM_STATUS_BUFFER_TOO_SMALL   应答缓冲区 < 4。
 */
static libspdm_return_t spdm_vendor_response(void *context, uint16_t req_standard_id,
					     uint8_t req_vendor_id_len, const void *req_vendor_id,
					     uint16_t req_size, const void *req_data,
					     uint16_t *resp_size, void *resp_data)
{
	static const uint8_t ping[4] = { '1', '1', '1', '1' };
	static const uint8_t pong[4] = { '2', '2', '2', '2' };

	ARG_UNUSED(context);
	ARG_UNUSED(req_standard_id);
	ARG_UNUSED(req_vendor_id_len);
	ARG_UNUSED(req_vendor_id);

	if ((req_data == NULL) || (resp_size == NULL) || (resp_data == NULL)) {
		return LIBSPDM_STATUS_INVALID_PARAMETER;
	}

	if ((req_size == sizeof(ping)) && (memcmp(req_data, ping, sizeof(ping)) == 0)) {
		if (*resp_size < sizeof(pong)) {
			return LIBSPDM_STATUS_BUFFER_TOO_SMALL;
		}
		memcpy(resp_data, pong, sizeof(pong));
		*resp_size = sizeof(pong);
		LOG_INF("session ping 1111 -> 2222");
		return LIBSPDM_STATUS_SUCCESS;
	}

	/* 未知载荷：回空，让对端自己判断，不要把会话拆掉。 */
	*resp_size = 0;
	LOG_WRN("unknown vendor payload (%u bytes)", req_size);
	return LIBSPDM_STATUS_SUCCESS;
}

/**
 * @brief 分配并配置 libspdm 响应端上下文。
 *
 * 分四步：
 * 1. 分配 context，调用 libspdm_init_context()。
 * 2. 注册三组与传输相关的回调（I/O、MCTP 编解码、收发 buffer）。
 * 3. 分配 scratch，供 encode/decode 临时使用。
 * 4. libspdm_set_data() 写入本端能力：版本、capability、算法、证书、多密钥绑定。
 *    GET_CAPABILITIES / NEGOTIATE_ALGORITHMS 应答就读这些值。
 *
 * 无入参。结果写到全局 spdm_context / spdm_scratch。
 *
 * @retval 0        成功，上下文已就绪。
 * @retval -ENOMEM  上下文或 scratch 分配失败。
 * @retval -EIO     libspdm_init_context() 或 vendor 回调注册失败。
 * @retval -EINVAL  libspdm_check_context() 失败（buffer 尺寸等不自洽）。
 */
static int spdm_responder_init(void)
{
	libspdm_data_parameter_t parameter;
	libspdm_return_t status;
	size_t ctx_size;
	size_t scratch_size;
	uint8_t data8;
	uint16_t data16;
	uint32_t data32;
	spdm_version_number_t spdm_version;

	/* ---------- 1. 分配并初始化 libspdm 上下文 ---------- */
	/* 大小 = sizeof(spdm_context) + 每个 session 的 secured_message 上下文。
	 * 当前 MAX_SESSION_COUNT=1，即使不做会话也会占一块。
	 */
	ctx_size = libspdm_get_context_size();
	LOG_INF("libspdm context size: %u", (unsigned int)ctx_size);

	spdm_context = k_malloc(ctx_size);
	if (spdm_context == NULL) {
		LOG_ERR("Failed to allocate SPDM context");
		return -ENOMEM;
	}

	memset(spdm_context, 0, ctx_size);
	status = libspdm_init_context(spdm_context);
	if (LIBSPDM_STATUS_IS_ERROR(status)) {
		LOG_ERR("libspdm_init_context failed: 0x%x", status);
		return -EIO;
	}

	/* ---------- 2. 注册与 MCTP 对接的三组回调 ---------- */
	/* 设备 I/O：dispatch 时 receive 读 pending_rx，send 走 mctp_message_tx。 */
	libspdm_register_device_io_func(spdm_context, spdm_device_send_message,
					spdm_device_receive_message);
	/* 传输层：给 SPDM 报文加减 1 字节 MCTP message type（0x05/0x06）。
	 * 头/尾尺寸给 libspdm 算 DataTransferSize，须小于 sender/receiver buffer。
	 */
	libspdm_register_transport_layer_func(spdm_context, SPDM_MAX_MSG_SIZE,
					      LIBSPDM_MCTP_TRANSPORT_HEADER_SIZE,
					      LIBSPDM_MCTP_TRANSPORT_TAIL_SIZE,
					      libspdm_transport_mctp_encode_message,
					      libspdm_transport_mctp_decode_message);
	/* 收发工作内存：encode 写 sender_buf，decode 读 receiver_buf。 */
	libspdm_register_device_buffer_func(spdm_context, SPDM_SENDER_BUFFER_SIZE,
					    SPDM_RECEIVER_BUFFER_SIZE, spdm_acquire_sender_buffer,
					    spdm_release_sender_buffer,
					    spdm_acquire_receiver_buffer,
					    spdm_release_receiver_buffer);

	/* ---------- 3. scratch：安全消息/分片等临时区，普通 VERSION 也会用到 ---------- */
	scratch_size = libspdm_get_sizeof_required_scratch_buffer(spdm_context);
	spdm_scratch = k_malloc(scratch_size);
	if (spdm_scratch == NULL) {
		LOG_ERR("Failed to allocate SPDM scratch buffer (%u)", (unsigned int)scratch_size);
		return -ENOMEM;
	}
	LOG_INF("SPDM scratch buffer size: %u", (unsigned int)scratch_size);
	memset(spdm_scratch, 0, scratch_size);
	libspdm_set_scratch_buffer(spdm_context, spdm_scratch, scratch_size);

	/* ---------- 4. 本端 SPDM 能力（GET_CAPABILITIES / NEGOTIATE_ALGORITHMS 的答案） ---------- */
	/* LOCATION_LOCAL = 本端声明的能力，不是协商后的 connection 值。 */
	memset(&parameter, 0, sizeof(parameter));
	parameter.location = LIBSPDM_DATA_LOCATION_LOCAL;

	/* 只声明 SPDM 1.3。VERSION 应答里的入口由此生成。
	 * SPDM_VERSION_NUMBER_SHIFT_BIT 把主/次版本挪到规范规定的 bit 位。
	 */
	spdm_version = SPDM_MESSAGE_VERSION_13 << SPDM_VERSION_NUMBER_SHIFT_BIT;
	libspdm_set_data(spdm_context, LIBSPDM_DATA_SPDM_VERSION, &parameter, &spdm_version,
			 sizeof(spdm_version));

	/* CTExponent：计算复杂度超时 2^ct 微秒。0 表示最小等待。 */
	data8 = 0;
	libspdm_set_data(spdm_context, LIBSPDM_DATA_CAPABILITY_CT_EXPONENT, &parameter, &data8,
			 sizeof(data8));

	/* CERT_CAP | CHAL_CAP：主机可走 GET_DIGESTS / GET_CERTIFICATE / CHALLENGE。
	 * KEY_EX_CAP：允许 KEY_EXCHANGE / FINISH，用 ECDHE 派生会话密钥。
	 * ENCRYPT_CAP | MAC_CAP：会话建立后用 AES-128-GCM 保护后续 SPDM。
	 * HANDSHAKE_IN_THE_CLEAR_CAP：FINISH 本身仍走明文（MCTP type 0x05）。
	 * EVENT_CAP：会话内 GET_SUPPORTED_EVENT_TYPES / SUBSCRIBE_EVENT_TYPES。
	 * MULTI_KEY_CAP_NEG：DIGESTS 可带 KeyPairID 绑定，由 OtherParams 协商。
	 * GET/SET_KEY_PAIR_INFO_CAP：查询/改密钥对与证书槽的绑定。
	 * 故意不声明 ENCAP_CAP：本例程不做封装互认证。
	 */
	data32 = SPDM_GET_CAPABILITIES_RESPONSE_FLAGS_CERT_CAP |
		 SPDM_GET_CAPABILITIES_RESPONSE_FLAGS_CHAL_CAP |
		 SPDM_GET_CAPABILITIES_RESPONSE_FLAGS_KEY_EX_CAP |
		 SPDM_GET_CAPABILITIES_RESPONSE_FLAGS_ENCRYPT_CAP |
		 SPDM_GET_CAPABILITIES_RESPONSE_FLAGS_MAC_CAP |
		 SPDM_GET_CAPABILITIES_RESPONSE_FLAGS_HANDSHAKE_IN_THE_CLEAR_CAP |
		 SPDM_GET_CAPABILITIES_RESPONSE_FLAGS_EVENT_CAP |
		 SPDM_GET_CAPABILITIES_RESPONSE_FLAGS_MULTI_KEY_CAP_NEG |
		 SPDM_GET_CAPABILITIES_RESPONSE_FLAGS_GET_KEY_PAIR_INFO_CAP |
		 SPDM_GET_CAPABILITIES_RESPONSE_FLAGS_SET_KEY_PAIR_INFO_CAP;
	libspdm_set_data(spdm_context, LIBSPDM_DATA_CAPABILITY_FLAGS, &parameter, &data32,
			 sizeof(data32));

	/* 哈希 / 非对称：NEGOTIATE_ALGORITHMS 会带回这些位；CHALLENGE 用 ECDSA P-256。 */
	data32 = SPDM_ALGORITHMS_BASE_HASH_ALGO_TPM_ALG_SHA_256;
	libspdm_set_data(spdm_context, LIBSPDM_DATA_BASE_HASH_ALGO, &parameter, &data32,
			 sizeof(data32));

	data32 = SPDM_ALGORITHMS_BASE_ASYM_ALGO_TPM_ALG_ECDSA_ECC_NIST_P256;
	libspdm_set_data(spdm_context, LIBSPDM_DATA_BASE_ASYM_ALGO, &parameter, &data32,
			 sizeof(data32));

	/* 测量规格/哈希：MEAS_CAP 未开，填 0。启用测量后改为 DMTF spec + SHA-256。 */
	data8 = 0;
	libspdm_set_data(spdm_context, LIBSPDM_DATA_MEASUREMENT_SPEC, &parameter, &data8,
			 sizeof(data8));

	data32 = 0;
	libspdm_set_data(spdm_context, LIBSPDM_DATA_MEASUREMENT_HASH_ALGO, &parameter, &data32,
			 sizeof(data32));

	/* 会话算法：KEY_EX 用 ECDHE P-256 交换临时公钥，AES-128-GCM 做 AEAD，
	 * key schedule 按 DSP0274 HMAC-Hash 从共享密钥派生 handshake/application key。
	 */
	data16 = SPDM_ALGORITHMS_DHE_NAMED_GROUP_SECP_256_R1;
	libspdm_set_data(spdm_context, LIBSPDM_DATA_DHE_NAME_GROUP, &parameter, &data16,
			 sizeof(data16));
	data16 = SPDM_ALGORITHMS_AEAD_CIPHER_SUITE_AES_128_GCM;
	libspdm_set_data(spdm_context, LIBSPDM_DATA_AEAD_CIPHER_SUITE, &parameter, &data16,
			 sizeof(data16));
	/* 0 = 不要求请求方出示证书（不做 MUT_AUTH）。 */
	data16 = 0;
	libspdm_set_data(spdm_context, LIBSPDM_DATA_REQ_BASE_ASYM_ALG, &parameter, &data16,
			 sizeof(data16));
	data16 = SPDM_ALGORITHMS_KEY_SCHEDULE_HMAC_HASH;
	libspdm_set_data(spdm_context, LIBSPDM_DATA_KEY_SCHEDULE, &parameter, &data16,
			 sizeof(data16));
	/* OpaqueDataFormat1 是 KEY_EX 的硬性要求，缺了会 InvalidRequest。
	 * MULTI_KEY_CONN 表示愿意做 ResponderMultiKeyConn：DIGESTS 带 KeyPairID。
	 */
	data8 = SPDM_ALGORITHMS_OPAQUE_DATA_FORMAT_1 | SPDM_ALGORITHMS_MULTI_KEY_CONN;
	libspdm_set_data(spdm_context, LIBSPDM_DATA_OTHER_PARAMS_SUPPORT, &parameter, &data8,
			 sizeof(data8));

	/* Slot 0：SPDM 证书链 blob（见 spdm_secret.c 文件头）。
	 * additional_data[0] = 槽号。GET_DIGESTS 对整段做 SHA-256；
	 * GET_CERTIFICATE 按偏移拷贝。设备私钥不在这里，签名走 HAL。
	 */
	parameter.additional_data[0] = 0;
	libspdm_set_data(spdm_context, LIBSPDM_DATA_LOCAL_PUBLIC_CERT_CHAIN, &parameter,
			 (void *)g_spdm_cert_chain, g_spdm_cert_chain_len);

	/* bit0 = 只提供 slot 0。 */
	data8 = 0x01;
	libspdm_set_data(spdm_context, LIBSPDM_DATA_LOCAL_SUPPORTED_SLOT_MASK, &parameter, &data8,
			 sizeof(data8));

	/* 多密钥绑定（SPDM 1.3）：把“证书槽”和“密钥对”对应起来。
	 * TOTAL_KEY_PAIRS=1：设备只有一把钥匙，id 从 1 起（0 非法）。
	 * additional_data[0] 是槽号：下面三条都是在描述 slot 0。
	 *   KEY_PAIR_ID=1           GET_DIGESTS 附加字段里的 KeyPairID
	 *   CERT_INFO=DeviceCert    证书模型（叶子是设备身份，不是别名证书）
	 *   KEY_USAGE=KEY_EX|CHAL   这把钥匙能做密钥交换和挑战
	 * 这些值必须和 spdm_secret.c 里 GET_KEY_PAIR_INFO HAL 返回的一致。
	 * 请求方 OtherParams 置 MULTI_KEY_CONN 后，DIGESTS 才会带这 4 字节。
	 */
	data8 = 1;
	libspdm_set_data(spdm_context, LIBSPDM_DATA_TOTAL_KEY_PAIRS, &parameter, &data8,
			 sizeof(data8));
	parameter.additional_data[0] = 0;
	data8 = 1;
	libspdm_set_data(spdm_context, LIBSPDM_DATA_LOCAL_KEY_PAIR_ID, &parameter, &data8,
			 sizeof(data8));
	data8 = SPDM_CERTIFICATE_INFO_CERT_MODEL_DEVICE_CERT;
	libspdm_set_data(spdm_context, LIBSPDM_DATA_LOCAL_CERT_INFO, &parameter, &data8,
			 sizeof(data8));
	data16 = SPDM_KEY_USAGE_BIT_MASK_KEY_EX_USE | SPDM_KEY_USAGE_BIT_MASK_CHALLENGE_USE;
	libspdm_set_data(spdm_context, LIBSPDM_DATA_LOCAL_KEY_USAGE_BIT_MASK, &parameter, &data16,
			 sizeof(data16));

	/* 会话内 VENDOR_DEFINED：主机发 1111，这里回 2222（AES-128-GCM，MCTP 0x06）。 */
	status = libspdm_register_vendor_get_id_callback_func(spdm_context, spdm_vendor_get_id);
	if (LIBSPDM_STATUS_IS_ERROR(status)) {
		LOG_ERR("register vendor get_id failed: 0x%x", status);
		return -EIO;
	}
	status = libspdm_register_vendor_callback_func(spdm_context, spdm_vendor_response);
	if (LIBSPDM_STATUS_IS_ERROR(status)) {
		LOG_ERR("register vendor callback failed: 0x%x", status);
		return -EIO;
	}

	/* 检查 buffer 尺寸、DataTransferSize 等是否自洽。 */
	if (!libspdm_check_context(spdm_context)) {
		LOG_ERR("libspdm_check_context failed");
		return -EINVAL;
	}

	LOG_INF("SPDM responder ready (SPDM 1.3, EVENT+MULTI_KEY, session 1111/2222)");
	return 0;
}

/**
 * @brief libmctp 收包回调：过滤 SPDM，缓存后唤醒 main()。
 *
 * USB 驱动组完一整条 MCTP 消息（可能已经重组过分片）后调用这里。
 * 只处理 type 0x05（明文 SPDM）和 0x06（加密 SPDM）；其它 type 丢掉。
 *
 * @param eid        源 Endpoint ID，回包时作为目的地址写入 pending_eid。
 * @param tag_owner  对端是否持有 message tag。请求一般为 true，本例程未使用。
 * @param msg_tag    MCTP message tag（0..7），回包时原样使用。
 * @param data       mctp_set_rx_all() 注册的用户指针，本例程为 NULL。
 * @param msg        MCTP 消息体，首字节为 message type。
 * @param len        msg 长度（字节）。
 *
 * @return 无。副作用：填充 pending_* 并 k_sem_give(spdm_rx_sem)。
 */
static void rx_message(uint8_t eid, bool tag_owner, uint8_t msg_tag, void *data, void *msg,
		       size_t len)
{
	uint8_t type;

	ARG_UNUSED(tag_owner);
	ARG_UNUSED(data);

	if ((msg == NULL) || (len == 0)) {
		return;
	}

	/* bit7 是 IC（完整性校验）标志，真正的 type 在低 7 位。 */
	type = ((uint8_t *)msg)[0] & 0x7f;
	if ((type != MCTP_MESSAGE_TYPE_SPDM) && (type != MCTP_MESSAGE_TYPE_SECURED_MCTP)) {
		LOG_INF("Ignore MCTP type 0x%02x from EID %u (%u bytes)", type, eid,
			(unsigned int)len);
		return;
	}

	if (len > sizeof(pending_rx)) {
		LOG_ERR("SPDM message too large: %u", (unsigned int)len);
		return;
	}

	memcpy(pending_rx, msg, len);
	pending_rx_len = len;
	pending_eid = eid;
	pending_msg_tag = msg_tag;
	pending_valid = true;
	k_sem_give(&spdm_rx_sem);
}

/**
 * @brief 例程入口：USB 枚举 → SPDM 初始化 → MCTP 收包循环。
 *
 * 阻塞在 spdm_rx_sem 上；每收到一帧 SPDM 请求调用一次
 * libspdm_responder_dispatch_message()。初始化失败时打印日志后返回 0，
 * 不复位系统。正常运行时 while(1) 不退出。
 *
 * @retval 0  初始化失败；或理论上不会走到（循环不退出）。
 */
int main(void)
{
	int ret;

	LOG_INF("SPDM over MCTP over USB, EID %d on %s", SELF_ID, CONFIG_BOARD_TARGET);

	ret = enable_usb_device_next();
	if (ret != 0) {
		LOG_ERR("Failed to enable USB device support");
		return 0;
	}

	/* 等主机完成 SET_CONFIGURATION，否则后面 MCTP 发不出去。 */
	while (!usb_configured) {
		k_msleep(5);
	}

	ret = spdm_responder_init();
	if (ret != 0) {
		LOG_ERR("SPDM responder init failed: %d", ret);
		return 0;
	}

	mctp_ctx = mctp_init();
	__ASSERT_NO_MSG(mctp_ctx != NULL);

	/* USB-MCTP 长度字段 1 字节且含 4 字节 USB 头，单包最大 255。
	 * Zephyr 默认 pkt_size = 255+4，封装后会超过 255，mctp_usb_tx 返回 -E2BIG，
	 * GET_CERTIFICATE 这种长响应就会让主机 USB 超时。改成 251 后 libmctp 会按此分片。
	 */
	mctp0.binding.pkt_size = MCTP_USB_MAX_PACKET_LENGTH - MCTP_USB_HEADER_SIZE;

	/* 把 USB binding 挂到本端 EID 10；所有消息都进 rx_message。 */
	mctp_register_bus(mctp_ctx, &mctp0.binding, SELF_ID);
	mctp_set_rx_all(mctp_ctx, rx_message, NULL);

	/* 响应端是被动的：USB 来一帧 SPDM → 信号量 → dispatch 一次。
	 * dispatch 内部会 receive → 按 opcode 处理 → send。
	 * 明文走 type 0x05，会话应用数据走 0x06（AES-128-GCM）。
	 */
	while (1) {
		libspdm_return_t status;

		k_sem_take(&spdm_rx_sem, K_FOREVER);
		status = libspdm_responder_dispatch_message(spdm_context);
		/* UNSUPPORTED_CAP 常见于对端探能力，不当错误刷屏。 */
		if (LIBSPDM_STATUS_IS_ERROR(status) && (status != LIBSPDM_STATUS_UNSUPPORTED_CAP)) {
			LOG_WRN("SPDM dispatch status: 0x%x", status);
		}
	}

	return 0;
}
```

## src/spdm_secret.c
```c
/*
 * Copyright 2026
 * SPDX-License-Identifier: Apache-2.0
 *
 * libspdm 响应端 secret HAL。
 *
 * libspdm 协议栈本身不持有设备私钥、也不知道本设备有哪些事件/密钥对。
 * 它在需要这些信息时回调本文件里的函数。请求方例程也会链接本文件：
 * 共享的 libspdm 库同时编了 requester_lib 和 responder_lib，链接时必须
 * 提供这些符号，即使请求方运行时几乎用不到签名/事件 HAL。
 *
 * -------------------------------------------------------------------------
 * 证书链怎么工作（DSP0274 slot 0）
 * -------------------------------------------------------------------------
 *
 * 生成：本例程 certs/gen_certs.py
 *   做出一对 ECDSA P-256 密钥：CA 自签 + 设备证（CA 签发）。
 *   再打成 SPDM 证书链 blob，写成本 sample 的 certs/certs_generated.h。
 *
 * g_spdm_cert_chain 布局（小端）：
 *
 *   [0..1]   Length     整段 blob 字节数（含这 4 字节头）
 *   [2..3]   Reserved   0
 *   [4..35]  RootHash   SHA-256(CA 的 DER)   —— GET_DIGESTS 哈希的一部分
 *   [36..]   DER 证书   先 CA，再 device     —— GET_CERTIFICATE 原样切出去
 *
 * 固件侧（公开材料 vs 私钥）：
 *   main.c 把 g_spdm_cert_chain 注册到 LIBSPDM_DATA_LOCAL_PUBLIC_CERT_CHAIN。
 *   GET_DIGESTS     = SHA-256(整段 chain blob)
 *   GET_CERTIFICATE = 按 offset/length 拷贝 chain blob
 *   本文件只提供 g_spdm_device_key_pem，给 CHALLENGE / KEY_EXCHANGE_RSP 签名。
 *
 * 主机侧：
 *   只拿 CA 的 PEM 验叶子证书。设备私钥不要给 Python 请求方。
 *
 * -------------------------------------------------------------------------
 * SPDM 1.3 两个本文件实现的特性
 * -------------------------------------------------------------------------
 *
 * 1) 事件订阅（EVENT_CAP）
 *    GET_SUPPORTED_EVENT_TYPES / SUBSCRIBE_EVENT_TYPES 只能在会话内发。
 *    规范要求至少支持 DMTF 组，且组里必须有 EventLost。
 *    KEY_EXCHANGE 若带 EVENT_ALL_POLICY，libspdm 会先回调
 *    libspdm_event_subscribe(ALL)。
 *
 * 2) 多密钥绑定（MULTI_KEY + GET/SET_KEY_PAIR_INFO）
 *    本例程只有 1 个密钥对：id=1，绑定证书槽 0，ECDSA P-256。
 *    GET_DIGESTS 在 32 字节摘要后跟 KeyPairID / CertInfo / KeyUsage。
 *    GET_KEY_PAIR_INFO 读下面的静态变量；SET_KEY_PAIR_INFO 可改绑定。
 */

#include <string.h>

#include <zephyr/kernel.h>
#include <zephyr/logging/log.h>

#include "hal/library/eventlib.h"
#include "hal/library/responder/asymsignlib.h"
#include "hal/library/responder/key_pair_info.h"
#include "industry_standard/spdm.h"
#include "library/spdm_crypt_lib.h"
#include "spdm_crypt_ext_lib/spdm_crypt_ext_lib.h"

#include "certs_generated.h"

LOG_MODULE_REGISTER(spdm_secret, LOG_LEVEL_INF);

/**
 * @brief 填写 CHALLENGE_AUTH 里的 OpaqueData。
 *
 * libspdm 组 CHALLENGE_AUTH 时会回调这里。本例程没有厂商私有字段，
 * 把长度写成 0；报文里仍会带 2 字节 OpaqueLength=0。
 *
 * @param spdm_version                   协商后的 SPDM 版本，本例程未使用。
 * @param slot_id                        本次挑战使用的证书槽，本例程未使用。
 * @param measurement_summary_hash       测量摘要（未开 MEAS 时为 NULL），未使用。
 * @param measurement_summary_hash_size  上面缓冲区长度，未使用。
 * @param opaque_data                    出参：要写入应答的 OpaqueData。长度为 0 时可不写。
 * @param opaque_data_size               入参是缓冲区容量；出参是实际写入字节数。
 *
 * @retval true   已把 *opaque_data_size 设为 0。
 * @retval false  opaque_data_size 为空指针。
 */
bool libspdm_challenge_opaque_data(spdm_version_number_t spdm_version, uint8_t slot_id,
				   uint8_t *measurement_summary_hash,
				   size_t measurement_summary_hash_size, void *opaque_data,
				   size_t *opaque_data_size)
{
	ARG_UNUSED(spdm_version);
	ARG_UNUSED(slot_id);
	ARG_UNUSED(measurement_summary_hash);
	ARG_UNUSED(measurement_summary_hash_size);
	/* 长度为 0，不往 opaque_data 里写内容。 */
	ARG_UNUSED(opaque_data);

	if (opaque_data_size == NULL) {
		return false;
	}

	*opaque_data_size = 0;
	return true;
}

/**
 * @brief 封装（ENCAP）互认证路径上的 CHALLENGE OpaqueData。
 *
 * 本例程未开 MUT_AUTH / ENCAP_CAP，运行时不会走到这里。
 * 为满足链接符号，直接复用上面的空实现。
 *
 * @param spdm_version                   同 libspdm_challenge_opaque_data()。
 * @param slot_id                        同 libspdm_challenge_opaque_data()。
 * @param measurement_summary_hash       同 libspdm_challenge_opaque_data()。
 * @param measurement_summary_hash_size  同 libspdm_challenge_opaque_data()。
 * @param opaque_data                    同 libspdm_challenge_opaque_data()。
 * @param opaque_data_size               同 libspdm_challenge_opaque_data()。
 *
 * @retval true   已把长度写成 0。
 * @retval false  参数非法。
 */
bool libspdm_encap_challenge_opaque_data(spdm_version_number_t spdm_version, uint8_t slot_id,
					 uint8_t *measurement_summary_hash,
					 size_t measurement_summary_hash_size, void *opaque_data,
					 size_t *opaque_data_size)
{
	return libspdm_challenge_opaque_data(spdm_version, slot_id, measurement_summary_hash,
					     measurement_summary_hash_size, opaque_data,
					     opaque_data_size);
}

/**
 * @brief 响应端非对称签名：用设备私钥签 transcript。
 *
 * libspdm 在下列应答里需要设备签名时调用本函数：
 *   CHALLENGE_AUTH     op_code = SPDM_CHALLENGE_AUTH
 *   KEY_EXCHANGE_RSP   op_code = SPDM_KEY_EXCHANGE_RSP
 *
 * 本例程每次从 PEM 解析私钥再签。量产应改成从 OTP / 安全元件取钥，
 * 保持本函数签名即可。
 *
 * @param spdm_version    协商版本，传给 cryptlib 选 signing context
 *                        （1.3 前缀是 "dmtf-spdm-v1.3.*"）。
 * @param op_code         当前 SPDM 操作码，决定 signing context 后缀。
 * @param base_asym_algo  协商出的非对称算法（本例程：ECDSA P-256）。
 * @param base_hash_algo  协商出的哈希算法（本例程：SHA-256）。
 * @param is_data_hash    true  = message 已经是 transcript 哈希，走 sign_hash；
 *                        false = message 是原文，由 cryptlib 自己做哈希。
 *                        SPDM 1.2/1.3 常见路径是 true。
 * @param message         待签数据（哈希或原文）。
 * @param message_size    message 字节数。
 * @param signature       出参：签名。ECDSA P-256 为 64 字节 r||s。
 * @param sig_size        入参是缓冲区容量；出参是实际签名长度。
 *
 * @retval true   签名已写入 signature / *sig_size。
 * @retval false  PEM 解析失败，或底层 sign 失败。
 */
bool libspdm_responder_data_sign(spdm_version_number_t spdm_version, uint8_t op_code,
				 uint32_t base_asym_algo, uint32_t base_hash_algo, bool is_data_hash,
				 const uint8_t *message, size_t message_size, uint8_t *signature,
				 size_t *sig_size)
{
	void *context;
	bool result;

	/* PEM → mbedtls 私钥上下文。第三参 password 为 NULL：本例程私钥未加密。 */
	result = libspdm_asym_get_private_key_from_pem(
		base_asym_algo, (const uint8_t *)g_spdm_device_key_pem,
		sizeof(g_spdm_device_key_pem), NULL, &context);
	if (!result) {
		return false;
	}

	if (is_data_hash) {
		/* SPDM 1.3 默认路径：先 Hash(transcript)，再包 signing context 后签。 */
		result = libspdm_asym_sign_hash(spdm_version, op_code, base_asym_algo,
						base_hash_algo, context, message, message_size,
						signature, sig_size);
	} else {
		/* 少见路径：cryptlib 对原文自己做哈希再签。 */
		result = libspdm_asym_sign(spdm_version, op_code, base_asym_algo, base_hash_algo,
					   context, message, message_size, signature, sig_size);
	}

	/* 无论成败都要释放私钥上下文，避免堆泄漏。 */
	libspdm_asym_free(base_asym_algo, context);
	return result;
}

/*
 * SPDM 1.3 事件组编码（DSP0274 SupportedEventGroupsList 里的一组）。
 *
 * 字段顺序必须与规范一致，所以用 pack(1)：
 *   RegistryID        1  0 = DMTF
 *   VendorIDLen       1  DMTF 组没有 VendorID，填 0
 *   EventTypeCount    2  本组有几种事件
 *   EventGroupVersion 2
 *   Attributes        4  bit0=ALL 表示支持“订阅本组全部事件”
 *   随后每个事件类型：EventTypeID(2) + Reserved(2)
 *
 * 规范：DMTF 组必须包含 EventLost(1)。本例程再加 CertificateChanged(4)。
 */
#pragma pack(1)
struct spdm_event_group_dmtf {
	uint8_t registry_id;
	uint8_t vendor_id_len;
	uint16_t event_type_count;
	uint16_t event_group_ver;
	uint32_t attributes;
	uint16_t type0_id;
	uint16_t type0_rsvd;
	uint16_t type1_id;
	uint16_t type1_rsvd;
};
#pragma pack()

/** 当前会话是否已订阅事件。本例程只记状态，不主动 SEND_EVENT。 */
static bool g_event_subscribed;
/** 订阅所属 session_id，退订时清 0。 */
static uint32_t g_event_session_id;

/**
 * @brief GET_SUPPORTED_EVENT_TYPES 的 HAL：回报本设备支持哪些事件。
 *
 * libspdm 组应答时调用。必须已经建立安全会话，否则协议层会先回
 * SESSION_REQUIRED，不会进到这里。
 *
 * @param spdm_context                     libspdm 上下文，本例程未使用。
 * @param spdm_version                     协商版本，本例程未使用。
 * @param session_id                       当前会话 ID，本例程未使用（只报静态能力）。
 * @param supported_event_groups_list      出参：按规范 pack 的事件组列表。
 * @param supported_event_groups_list_len  入参是缓冲区容量；出参是实际写入长度。
 * @param event_group_count                出参：组数。本例程固定为 1（DMTF 组）。
 *
 * @retval true   已写入 1 个 DMTF 组（EventLost + CertificateChanged）。
 * @retval false  指针为空，或调用方缓冲区小于 sizeof(group)。
 */
bool libspdm_event_get_types(void *spdm_context, spdm_version_number_t spdm_version,
			     uint32_t session_id, void *supported_event_groups_list,
			     uint32_t *supported_event_groups_list_len, uint8_t *event_group_count)
{
	struct spdm_event_group_dmtf group;

	ARG_UNUSED(spdm_context);
	ARG_UNUSED(spdm_version);
	ARG_UNUSED(session_id);

	if ((supported_event_groups_list == NULL) || (supported_event_groups_list_len == NULL) ||
	    (event_group_count == NULL)) {
		return false;
	}

	/* 调用方给的缓冲区必须能放下整组 DMTF 描述。 */
	if (*supported_event_groups_list_len < sizeof(group)) {
		return false;
	}

	memset(&group, 0, sizeof(group));
	group.registry_id = SPDM_REGISTRY_ID_DMTF; /* 0：DMTF 标准事件，不是厂商私有。 */
	group.vendor_id_len = 0;                   /* DMTF 组没有 VendorID 字段。 */
	group.event_type_count = 2;                /* 本组两种事件：Lost + CertChanged。 */
	group.event_group_ver = 1;
	group.attributes = 0;                      /* bit0 未置：本例程不声明“支持 ALL”。 */
	group.type0_id = SPDM_DMTF_EVENT_TYPE_EVENT_LOST;           /* 规范强制要有。 */
	group.type0_rsvd = 0;
	group.type1_id = SPDM_DMTF_EVENT_TYPE_CERTIFICATE_CHANGED;  /* 演示用第二种。 */
	group.type1_rsvd = 0;

	memcpy(supported_event_groups_list, &group, sizeof(group));
	*supported_event_groups_list_len = sizeof(group);
	*event_group_count = 1;
	return true;
}

/**
 * @brief SUBSCRIBE_EVENT_TYPES 的 HAL：记录订阅 / 退订。
 *
 * subscribe_type 由 libspdm 根据请求翻译，不是报文里的原始 Param1：
 *   ALL    KEY_EXCHANGE 带 EVENT_ALL_POLICY，或请求订阅全部
 *   NONE   请求 Param1=0，即退订
 *   LIST   请求带具体事件组列表
 *
 * 本例程只记“是否已订阅”和 session_id，不会主动 SEND_EVENT。
 *
 * @param spdm_context                 libspdm 上下文，本例程未使用。
 * @param spdm_version                 协商版本，本例程未使用。
 * @param session_id                   发起订阅的会话；退订时用来清状态。
 * @param subscribe_type               ALL / NONE / LIST，见上。
 * @param subscribe_event_group_count  LIST 时的组数；ALL/NONE 时应为 0。
 * @param subscribe_list_len           LIST 时列表字节数；ALL/NONE 必须为 0。
 * @param subscribe_list               LIST 时的组列表；ALL/NONE 必须为 NULL。
 *
 * @retval true   状态已更新。
 * @retval false  类型非法，或 ALL/NONE 却带了 list，或 LIST 却缺 list。
 */
bool libspdm_event_subscribe(void *spdm_context, spdm_version_number_t spdm_version,
			     uint32_t session_id, uint8_t subscribe_type,
			     uint8_t subscribe_event_group_count, uint32_t subscribe_list_len,
			     const void *subscribe_list)
{
	ARG_UNUSED(spdm_context);
	ARG_UNUSED(spdm_version);

	switch (subscribe_type) {
	case LIBSPDM_EVENT_SUBSCRIBE_ALL:
		/* 规范：ALL 时不得再带列表，否则视为 InvalidRequest。 */
		if ((subscribe_list_len != 0) || (subscribe_list != NULL)) {
			return false;
		}
		g_event_subscribed = true;
		g_event_session_id = session_id;
		LOG_INF("event subscribe ALL session=0x%x", session_id);
		return true;
	case LIBSPDM_EVENT_SUBSCRIBE_NONE:
		/* 退订：同样不允许带列表。 */
		if ((subscribe_list_len != 0) || (subscribe_list != NULL)) {
			return false;
		}
		g_event_subscribed = false;
		g_event_session_id = 0;
		LOG_INF("event unsubscribe ALL session=0x%x", session_id);
		return true;
	case LIBSPDM_EVENT_SUBSCRIBE_LIST:
		/* LIST 必须有非空列表。本例程不解析内容，只要非空就接受。 */
		if ((subscribe_event_group_count == 0) || (subscribe_list_len == 0) ||
		    (subscribe_list == NULL)) {
			return false;
		}
		g_event_subscribed = true;
		g_event_session_id = session_id;
		LOG_INF("event subscribe LIST groups=%u len=%u session=0x%x",
			subscribe_event_group_count, subscribe_list_len, session_id);
		return true;
	default:
		return false;
	}
}

/*
 * 多密钥：本例程只有一把 ECDSA P-256 密钥。
 *
 * SPDM 1.3 把“密钥对”和“证书槽”拆开：
 *   key_pair_id   从 1 起编号，0 非法
 *   slot          证书槽 0..7，本例程只用 slot 0
 *   assoc_mask    bit0=1 表示这对密钥绑定了 slot 0
 *
 * GET_DIGESTS（协商了 MULTI_KEY_CONN 时）在 32 字节摘要后附带：
 *   KeyPairID(1) + CertInfo(1) + KeyUsage(2)
 * 这些值来自 main.c 的 LIBSPDM_DATA_LOCAL_KEY_PAIR_ID / CERT_INFO /
 * KEY_USAGE_BIT_MASK，与这里 HAL 返回的绑定应当一致。
 */
#define SPDM_SAMPLE_KEY_PAIR_ID 1
#define SPDM_SAMPLE_KEY_PAIR_COUNT 1

/*
 * AlgorithmIdentifier for id-ecPublicKey + secp256r1。
 * GET_KEY_PAIR_INFO 的 PublicKeyInfo 填这个 DER，主机可据此知道算法。
 * 不是完整 SubjectPublicKeyInfo（不含公钥点），规范允许只给算法 OID。
 */
static const uint8_t g_ecp256_spki_algid[] = {0x30, 0x13, 0x06, 0x07, 0x2A, 0x86, 0x48, 0xCE,
					      0x3D, 0x02, 0x01, 0x06, 0x08, 0x2A, 0x86, 0x48,
					      0xCE, 0x3D, 0x03, 0x01, 0x07};

/** 当前允许的用法：KEY_EX + CHALLENGE。SET CHANGE 可改。 */
static uint16_t g_key_usage = SPDM_KEY_USAGE_BIT_MASK_KEY_EX_USE |
			      SPDM_KEY_USAGE_BIT_MASK_CHALLENGE_USE;
/** 当前非对称算法：ECC256。 */
static uint32_t g_key_asym = SPDM_KEY_PAIR_ASYM_ALGO_CAP_ECC256;
/** 当前绑定的证书槽位图：0x01 = slot 0。 */
static uint8_t g_key_slot_mask = 0x01;

/**
 * @brief GET_KEY_PAIR_INFO 的 HAL：读一把密钥对的能力和当前绑定。
 *
 * public_key_info 可为 NULL：SET 路径有时只查能力，不取 PublicKeyInfo。
 * 能力位告诉主机“能改绑定 / 能改用法 / 能改算法”；没有 GEN_KEY / ERASABLE，
 * 所以上位机不应发 GENERATE / ERASE（协议层通常会先拒）。
 *
 * @param spdm_context            libspdm 上下文，本例程未使用。
 * @param key_pair_id             要查询的密钥对，从 1 起；本例程只认 1。
 * @param capabilities            出参：这把钥匙支持哪些 SET 操作。
 * @param key_usage_capabilities  出参：用法能设成哪些位（KEY_EX | CHALLENGE）。
 * @param current_key_usage       出参：当前用法，来自 g_key_usage。
 * @param asym_algo_capabilities  出参：算法能设成哪些（仅 ECC256）。
 * @param current_asym_algo       出参：当前算法，来自 g_key_asym。
 * @param assoc_cert_slot_mask    出参：绑定的证书槽位图，bit0=slot 0。
 * @param public_key_info_len     入参是缓冲区容量；出参是实际写入的 DER 长度。
 *                                可为 NULL。
 * @param public_key_info         出参：AlgorithmIdentifier DER。可为 NULL。
 *
 * @retval true   已填好出参。
 * @retval false  key_pair_id 非法，或 PublicKeyInfo 缓冲区太小。
 */
bool libspdm_read_key_pair_info(void *spdm_context, uint8_t key_pair_id, uint16_t *capabilities,
				uint16_t *key_usage_capabilities, uint16_t *current_key_usage,
				uint32_t *asym_algo_capabilities, uint32_t *current_asym_algo,
				uint8_t *assoc_cert_slot_mask, uint16_t *public_key_info_len,
				uint8_t *public_key_info)
{
	ARG_UNUSED(spdm_context);

	/* 规范：id 从 1 起。本例程只有一把钥匙。 */
	if ((key_pair_id == 0) || (key_pair_id > SPDM_SAMPLE_KEY_PAIR_COUNT)) {
		return false;
	}

	if (public_key_info_len != NULL) {
		if (*public_key_info_len < sizeof(g_ecp256_spki_algid)) {
			return false;
		}
		*public_key_info_len = sizeof(g_ecp256_spki_algid);
	}
	if (public_key_info != NULL) {
		memcpy(public_key_info, g_ecp256_spki_algid, sizeof(g_ecp256_spki_algid));
	}

	/* CERT_ASSOC / KEY_USAGE / ASYM_ALGO：允许 SET CHANGE 改这三项。 */
	*capabilities = SPDM_KEY_PAIR_CAP_CERT_ASSOC_CAP | SPDM_KEY_PAIR_CAP_KEY_USAGE_CAP |
			SPDM_KEY_PAIR_CAP_ASYM_ALGO_CAP;
	*key_usage_capabilities = SPDM_KEY_USAGE_BIT_MASK_KEY_EX_USE |
				  SPDM_KEY_USAGE_BIT_MASK_CHALLENGE_USE;
	*current_key_usage = g_key_usage;
	*asym_algo_capabilities = SPDM_KEY_PAIR_ASYM_ALGO_CAP_ECC256;
	*current_asym_algo = g_key_asym;
	*assoc_cert_slot_mask = g_key_slot_mask;
	return true;
}

/**
 * @brief SET_KEY_PAIR_INFO 的 HAL：改绑定 / 擦除 / 生成（演示）。
 *
 * operation:
 *   CHANGE    改 usage / 算法 / 槽位绑定。desired_key_usage、desired_asym_algo
 *             为 0 表示该项不改；槽位掩码总是按入参写入。
 *   ERASE     清空静态状态。本例程能力位未声明 ERASABLE，协议层通常会先拒。
 *   GENERATE  生成新密钥。未声明 GEN_KEY，协议层会拒；这里只是演示记状态，
 *             并不真的换 P-256 密钥。
 *
 * @param spdm_context                 libspdm 上下文，本例程未使用。
 * @param key_pair_id                  要改的密钥对，本例程只认 1。
 * @param operation                    CHANGE / ERASE / GENERATE。
 * @param desired_key_usage            CHANGE 时想要的用法；0 表示不改。
 * @param desired_asym_algo            CHANGE 时想要的算法；0 表示不改。
 * @param desired_assoc_cert_slot_mask CHANGE 时想绑定的槽位图。
 * @param need_reset                   出参：true 表示改完要复位才生效。
 *                                     本例程固定写 false，立刻生效。
 *
 * @retval true   状态已更新，*need_reset = false。
 * @retval false  id 非法、need_reset 为空，或 operation 无法识别。
 */
bool libspdm_write_key_pair_info(void *spdm_context, uint8_t key_pair_id, uint8_t operation,
				 uint16_t desired_key_usage, uint32_t desired_asym_algo,
				 uint8_t desired_assoc_cert_slot_mask, bool *need_reset)
{
	ARG_UNUSED(spdm_context);

	if ((key_pair_id == 0) || (key_pair_id > SPDM_SAMPLE_KEY_PAIR_COUNT) ||
	    (need_reset == NULL)) {
		return false;
	}

	if (operation == SPDM_SET_KEY_PAIR_INFO_ERASE_OPERATION) {
		g_key_usage = 0;
		g_key_asym = 0;
		g_key_slot_mask = 0;
		LOG_INF("key pair %u erased", key_pair_id);
	} else if (operation == SPDM_SET_KEY_PAIR_INFO_CHANGE_OPERATION) {
		/* 0 表示“这一项保持原值”，与 DSP0274 SET_KEY_PAIR_INFO 约定一致。 */
		if (desired_key_usage != 0) {
			g_key_usage = desired_key_usage;
		}
		if (desired_asym_algo != 0) {
			g_key_asym = desired_asym_algo;
		}
		g_key_slot_mask = desired_assoc_cert_slot_mask;
		LOG_INF("key pair %u bound slot_mask=0x%02x usage=0x%04x", key_pair_id,
			g_key_slot_mask, g_key_usage);
	} else if (operation == SPDM_SET_KEY_PAIR_INFO_GENERATE_OPERATION) {
		/* 演示：只更新元数据，私钥仍是 certs_generated.h 里那把 P-256。 */
		g_key_usage = desired_key_usage;
		g_key_asym = desired_asym_algo;
		g_key_slot_mask = desired_assoc_cert_slot_mask;
		LOG_INF("key pair %u generate (demo, reuse existing P-256)", key_pair_id);
	} else {
		return false;
	}

	*need_reset = false;
	return true;
}
```
