## samples/spdm/spdm_modules/Kconfig
```kconfig
# Copyright 2026
# SPDX-License-Identifier: Apache-2.0

config ZEPHYR_LIBSPDM_MODULE
	bool

config LIBSPDM
	bool "DMTF libspdm (SPDM 1.3 requester and responder)"
	select REQUIRES_STD_C11
	select MBEDTLS
	select MBEDTLS_ENABLE_HEAP
	select MBEDTLS_SHA256
	select MBEDTLS_MD
	select MBEDTLS_ECP_C
	select MBEDTLS_ECDSA_C
	select MBEDTLS_ECDH_C
	select MBEDTLS_ECP_DP_SECP256R1_ENABLED
	select MBEDTLS_CIPHER_AES_ENABLED
	select MBEDTLS_CIPHER_GCM_ENABLED
	select MBEDTLS_HKDF_C
	select MBEDTLS_PEM_CERTIFICATE_FORMAT
	select MBEDTLS_KEY_EXCHANGE_ECDHE_ECDSA_ENABLED
	select MBEDTLS_X509_CSR_WRITE_C
	select MBEDTLS_PK_WRITE_C
	help
	  Build DMTF libspdm with MCTP transport and Zephyr mbedtls
	  (cryptlib_mbedtls). Both requester and responder libraries are
	  compiled. SPDM 1.3 extras: EVENT_CAP (subscribe), GET/SET_KEY_PAIR_INFO
	  and multi-key DIGESTS fields. Samples choose the role at runtime.
```
