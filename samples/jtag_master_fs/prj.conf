## CMakeLists.txt
```
# SPDX-License-Identifier: Apache-2.0

cmake_minimum_required(VERSION 3.20.0)

find_package(Zephyr REQUIRED HINTS $ENV{ZEPHYR_BASE})
project(jtag_master)

target_sources(app PRIVATE src/main.c src/jtagm_fs.c src/i2c_fs.c src/uart_fs.c)
```

## prj.conf
```kconfig
# nothing here
CONFIG_JTAG=y
CONFIG_SHELL=y
CONFIG_POSIX_API=y
CONFIG_XOPEN_STREAMS=y
CONFIG_FILE_SYSTEM_MAX_TYPES=8
CONFIG_LOG=y
CONFIG_DEVFS=y
CONFIG_FILE_SYSTEM_SHELL=y
```

## src/main.c
```c
/*
 * Copyright (c) 2012-2014 Wind River Systems, Inc.
 *
 * SPDX-License-Identifier: Apache-2.0
 */

#include <zephyr/kernel.h>
#include <zephyr/device.h>
#include <zephyr/drivers/jtag.h>
#include <zephyr/posix/sys/ioctl.h>
#include <zephyr/posix/fcntl.h>
#include <zephyr/posix/sys/ioctl.h>
#include <zephyr/posix/unistd.h>
#include <zephyr/posix/dirent.h>
#include <zephyr/shell/shell.h>
#include "ioctl.h"
#include "jtagm_fs.h"
#include <string.h>

static int jtag_shift_ir(int fd, uint32_t ir_value, int ir_len)
{
    struct jtag_xfer xfer = {0};

    xfer.type = JTAG_SIR_XFER;
    xfer.length = ir_len;
    xfer.direction = JTAG_WRITE_XFER;
    xfer.tdio = (uintptr_t)&ir_value;
    xfer.endstate = JTAG_STATE_IDLE;

    return ioctl(fd, JTAG_IOCXFER, &xfer);
}

static int jtag_shift_dr_read32(int fd, uint32_t *out)
{
    uint32_t dummy = 0;
    struct jtag_xfer xfer = {0};

    xfer.type = JTAG_SDR_XFER;
    xfer.length = 32;
    xfer.direction = JTAG_READ_XFER;
    xfer.tdio = (uintptr_t)&dummy;
    xfer.endstate = JTAG_STATE_IDLE;

    int ret = ioctl(fd, JTAG_IOCXFER, &xfer);
    if (ret < 0)
        return ret;

    *out = dummy;
    return 0;
}

static int jtag_set_tap_state(int fd, enum jtag_tapstate tap_state)
{
    struct jtag_tap_state state = {
        .endstate = tap_state,
        .from = JTAG_STATE_IDLE,
        .reset = JTAG_NO_RESET,
        .tck = 0
    };

    int ret = ioctl(fd, JTAG_SIOCSTATE, &state);
    if (ret < 0)
        return ret;

    return 0;
}

static enum jtag_tapstate jtag_get_tap_state(int fd)
{
    enum jtag_tapstate tap_state;

    int ret = ioctl(fd, JTAG_GIOCSTATUS, &tap_state);
    if (ret < 0)
        return ret;

    return tap_state;
}

static int jtag_set_freq(int fd, uint32_t freq)
{
    int ret = ioctl(fd, JTAG_SIOCFREQ, &freq);
    if (ret < 0)
        return ret;

    return 0;
}

static int jtag_get_freq(int fd)
{
    uint32_t freq;
    int ret = ioctl(fd, JTAG_GIOCFREQ, &freq);
    if (ret < 0)
        return ret;

    return freq;
}

static int gd32_read_id_code(const struct shell *shell, size_t argc, char **argv, void *data)
{
    static uint8_t gd32_id_code[4] = {0x3d,0x56,0x0,0x10};  //GD32 id-code：0x1000563d
    enum jtag_tapstate state;
    uint32_t id_code;
    int fd = open("/dev/jtag/jtag3", O_RDWR);

    if (fd > 0)
    {
        printk("cur freq: %d\n", jtag_get_freq(fd));
        printk("set freq: %d\n", 5000000);
        jtag_set_freq(fd, 5000000);
        printk("get freq: %d\n", jtag_get_freq(fd));

        jtag_set_tap_state(fd, JTAG_STATE_IDLE);
        state = jtag_get_tap_state(fd);

        jtag_shift_ir(fd, 1, 5);

        jtag_set_tap_state(fd, JTAG_STATE_SHIFTDR);
        jtag_shift_dr_read32(fd, &id_code);
        if (memcmp(gd32_id_code, &id_code, 4) == 0)
            printk("read id code ok.\n");

        close(fd);
    }

    return 0;
}
SHELL_CMD_REGISTER(gd32_read_id_code, NULL, "gd32_read_id_code", gd32_read_id_code);


static int i2c_fs_test(const struct shell *shell, size_t argc, char **argv, void *data)
{
    int fd = open("/dev/i2c1", O_RDWR);
    char read_buf[16];

    if (fd > 0)
    {
        ioctl(fd, 1);
        ioctl(fd, 2);

        write(fd, "write i2c1", strlen("write i2c1"));
        int len = read(fd, read_buf, 16);
        printk("read len: %d, read buf: %s\n", len, read_buf);

        close(fd);
    }

    fd = open("/dev/i2c2", O_RDWR);
    if (fd > 0)
    {
        ioctl(fd, 1);
        ioctl(fd, 2);

        write(fd, "write i2c2", strlen("write i2c2"));
        int len = read(fd, read_buf, 16);
        printk("read len: %d, read buf: %s\n", len, read_buf);

        close(fd);
    }

    fd = open("/dev/i2c/i2c3", O_RDWR);
    if (fd > 0)
    {
        ioctl(fd, 1);
        ioctl(fd, 2);

        write(fd, "write i2c3", strlen("write i2c3"));
        int len = read(fd, read_buf, 16);
        printk("read len: %d, read buf: %s\n", len, read_buf);

        close(fd);
    }

    return 0;
}
SHELL_CMD_REGISTER(i2c_fs_test, NULL, "i2c_fs_test", i2c_fs_test);

static int uart_fs_test(const struct shell *shell, size_t argc, char **argv, void *data)
{
    int fd = open("/dev/uart1", O_RDWR);

    if (fd > 0)
    {
        ioctl(fd, 1);
        ioctl(fd, 2);
        close(fd);
    }

    fd = open("/dev/uart2", O_RDWR);
    if (fd > 0)
    {
        ioctl(fd, 1);
        ioctl(fd, 2);
        close(fd);
    }

    fd = open("/dev/uart/uart3", O_RDWR);
    if (fd > 0)
    {
        ioctl(fd, 1);
        ioctl(fd, 2);
        close(fd);
    }

    return 0;
}
SHELL_CMD_REGISTER(uart_fs_test, NULL, "uart_fs_test", uart_fs_test);

int main(void)
{
    return 0;
}
 
```

## src/i2c_fs.c
```c
/*
 * Copyright (c) 2016 Intel Corporation.
 * Copyright 2024 NXP
 *
 * SPDX-License-Identifier: Apache-2.0
 */
#include <stdlib.h>
#include <stdarg.h>
#include <zephyr/fs/fs.h>
#include <zephyr/fs/fs_sys.h>
#include <zephyr/sys/fdtable.h>
#include <zephyr/fs/devfs.h>

static int i2c_open(struct fs_file_t *zfp, const char *name, fs_mode_t flags)
{
    printk("open %s.\n", name);
    zfp->filep = (void *)name;
    return 0;
}

static int i2c_close(struct fs_file_t *zfp)
{
    printk("%s close.\n", (char *)zfp->filep);
    return 0;
}

static int i2c_ioctl(struct fs_file_t *zfp, unsigned long cmd, va_list args)
{
    switch (cmd)
    {
    case 1:
        printk("i2c ioctl %ld.\n", cmd);
        break;
    case 2:
        printk("i2c ioctl %ld.\n", cmd);
        break;
    }
    return 0;
}

static int i2c_read(struct fs_file_t *filp, void *dest, size_t nbytes)
{
    int len = snprintk(dest, nbytes, "hello %s", (const char *)filp->filep);
    return len;
}

static ssize_t i2c_write(struct fs_file_t *zfp, const void *src, size_t nbytes)
{
    printk("%s, %d\n", (const char *)src, nbytes);
    return nbytes;
}

static const struct fs_file_system_t i2c_fs = {
    .open = i2c_open,
    .read = i2c_read,
    .write = i2c_write,
    .close = i2c_close,
    .ioctl = i2c_ioctl
};

static int i2c_fs_init(void)
{
    devfs_register("/dev/i2c1", &i2c_fs);
    devfs_register("/dev/i2c2", &i2c_fs);
    devfs_register("/dev/i2c/i2c3", &i2c_fs);
    return 0;
}
SYS_INIT(i2c_fs_init, APPLICATION, CONFIG_FILE_SYSTEM_INIT_PRIORITY);
```

## src/jtagm_fs.c
```c
/*
 * Copyright (c) 2016 Intel Corporation.
 * Copyright 2024 NXP
 *
 * SPDX-License-Identifier: Apache-2.0
 */

#include <stdio.h>
#include <stdlib.h>
#include <stdarg.h>
#include <zephyr/fs/fs.h>
#include <zephyr/fs/fs_sys.h>
#include <zephyr/device.h>
#include <zephyr/devicetree.h>
#include <zephyr/logging/log.h>
#include <zephyr/sys/atomic.h>
#include <zephyr/posix/fcntl.h>
#include <zephyr/sys/fdtable.h>
#include <zephyr/drivers/jtag.h>
#include "jtagm_fs.h"
#include "ioctl.h"

#define DT_DRV_COMPAT linkedsemi_ls_jtag

LOG_MODULE_REGISTER(jtagm_dev, LOG_LEVEL_INF);

#define JTAGM_NUM       DT_NUM_INST_STATUS_OKAY(DT_DRV_COMPAT)

static struct fs_mount_t jtagm_fs_mnt = {
    .type = FS_JTAGM,
    .mnt_point = JTAGM_MNT_POINT
};

struct jtagm_device
{
    const struct device *dev;
    const char *label;
    atomic_t is_open;
};

#define JTAGM_DEVICE_PROCESS(inst)                            \
    {                                                       \
        .dev = DEVICE_DT_GET(DT_INST(inst, DT_DRV_COMPAT)), \
        .label = DT_INST_PROP(inst, label),                  \
        .is_open = ATOMIC_INIT(0)                             \
    },

static struct jtagm_device jtag_devices[] = {
    DT_INST_FOREACH_STATUS_OKAY(JTAGM_DEVICE_PROCESS)
};

static const char *get_filename(const char *path)
{
    const char *p = strrchr(path, '/');
    return p ? p + 1 : path;
}

static int jtagm_open(struct fs_file_t *zfp, const char *path, fs_mode_t mode)
{
    struct jtagm_device *jtag = NULL;
    const char *name = get_filename(path);

    for (int i = 0; i < JTAGM_NUM; i++)
    {
        if (strcmp(jtag_devices[i].label, name) == 0)
        {
            jtag = &jtag_devices[i];
            break;
        }
    }

    if (!jtag || !device_is_ready(jtag->dev))
    {
        LOG_ERR("Device %s not ready", name);
        return -ENODEV;
    }

    if (!atomic_cas(&jtag->is_open, 0, 1))
    {
        LOG_ERR("Device %s already opened", name);
        return -EBUSY;
    }

    if(jtag_tap_set(jtag->dev, TAP_RESET))
    {
        LOG_ERR("Device %s reset fail", name);
        return -EBUSY; 
    }
    zfp->filep = jtag;

    return 0;
}

static int jtagm_close(struct fs_file_t *zfp)
{
    struct jtagm_device *jtag = zfp->filep;
    if (jtag)
    {
        atomic_set(&jtag->is_open, 0);
        jtag_tap_set(jtag->dev, TAP_RESET);
    }
    return 0;
}

static enum tap_state usr_state_2_kernel_state[JTAG_STATE_CURRENT] = {
    TAP_RESET,TAP_IDLE,
    TAP_DRSELECT,TAP_DRCAPTURE,TAP_DRSHIFT,TAP_DREXIT1,TAP_DRPAUSE,TAP_DREXIT2,TAP_DRUPDATE,
    TAP_IRSELECT,TAP_IRCAPTURE,TAP_IRSHIFT,TAP_IREXIT1,TAP_IRPAUSE,TAP_IREXIT2,TAP_IRUPDATE
};

static enum jtag_tapstate kernel_state_2_usr_state[TAP_RESET+1] = {
    JTAG_STATE_EXIT2DR,JTAG_STATE_EXIT1DR,JTAG_STATE_SHIFTDR,JTAG_STATE_PAUSEDR,
    JTAG_STATE_SELECTIR,JTAG_STATE_UPDATEDR,JTAG_STATE_CAPTUREDR,JTAG_STATE_SELECTDR,
    JTAG_STATE_EXIT2IR,JTAG_STATE_EXIT1IR,JTAG_STATE_SHIFTIR,JTAG_STATE_PAUSEIR,
    JTAG_STATE_IDLE,JTAG_STATE_UPDATEIR,JTAG_STATE_CAPTUREIR,JTAG_STATE_TLRESET
};

static int jtagm_ioctl(struct fs_file_t *zfp, unsigned long cmd, va_list args)
{
    int ret = 0;
    struct jtagm_device *jtag = zfp->filep;
    uint32_t *freq;

    switch (cmd)
    {
    case JTAG_SIOCSTATE:
        struct jtag_tap_state *tapstate = va_arg(args, struct jtag_tap_state *);
        ret = jtag_tap_set(jtag->dev, usr_state_2_kernel_state[tapstate->endstate]);
        break;
    case JTAG_IOCXFER:
        struct jtag_xfer *xfer = va_arg(args, struct jtag_xfer *);
        if (xfer->type == JTAG_SIR_XFER)
        {
            ret = jtag_ir_scan(jtag->dev, xfer->length, (const uint8_t *)(uintptr_t)xfer->tdio, NULL, TAP_IDLE);
        }
        else
        {
            ret = jtag_dr_scan(jtag->dev, xfer->length, NULL, (uint8_t *)(uintptr_t)xfer->tdio, TAP_IDLE);
        }
        break;
    case JTAG_GIOCSTATUS:
        enum jtag_tapstate *state = va_arg(args, enum jtag_tapstate *);
        ret = jtag_tap_get(jtag->dev, (enum tap_state *)state);
        *state = kernel_state_2_usr_state[*(enum tap_state *)state];
        break;
    case JTAG_SIOCMODE:
        {
            struct jtag_mode *mode = va_arg(args, struct jtag_mode *);
            switch (mode->feature) 
            {
            case JTAG_XFER_MODE:
                break;
            case JTAG_CONTROL_MODE:
                break;
            default:
                return -EINVAL;
            }
        }
        break;
    case JTAG_SIOCFREQ:
        freq = va_arg(args, uint32_t *);
        ret = jtag_freq_set(jtag->dev, *freq);
        break;
    case JTAG_GIOCFREQ:
        freq = va_arg(args, uint32_t *);
        ret = jtag_freq_get(jtag->dev, freq);
        break;
    case JTAG_IOCBITBANG:
        break;
    case JTAG_SIOCTRST:
        break;
    default:
        return -EINVAL;
    }

    return ret;
}

static int jtagm_mount(struct fs_mount_t *mountp)
{
    return 0;
}

static int jtagm_unmount(struct fs_mount_t *mountp)
{
    return 0;
}

static const struct fs_file_system_t jtagm_fs = {
    .mount = jtagm_mount,
    .unmount = jtagm_unmount,
    .open = jtagm_open,
    .close = jtagm_close,
    .ioctl = jtagm_ioctl,
};

static int jtagm_fs_init(void)
{
    int ret = fs_register(FS_JTAGM, &jtagm_fs);
    if (!ret)
        ret = fs_mount(&jtagm_fs_mnt);

    return ret;
}

SYS_INIT(jtagm_fs_init, POST_KERNEL, CONFIG_FILE_SYSTEM_INIT_PRIORITY);
```

## src/jtagm_fs.h
```c
#ifndef __JTAGM_FS_H
#define __JTAGM_FS_H


/*
 * JTAG_XFER_MODE: JTAG transfer mode. Used to set JTAG controller transfer mode
 * This is bitmask for feature param in jtag_mode for ioctl JTAG_SIOCMODE
 */
#define  JTAG_XFER_MODE 0
/*
 * JTAG_CONTROL_MODE: JTAG controller mode. Used to set JTAG controller mode
 * This is bitmask for feature param in jtag_mode for ioctl JTAG_SIOCMODE
 */
#define  JTAG_CONTROL_MODE 1
/*
 * JTAG_TCK_CYCLE_DELAY_COUNT: JTAG delay counter for aspeed_jtag_tck_cycle. Used
 * set the number of jtag_tck_cycle delays repetitions.
 * This is bitmask for feature param in jtag_mode for ioctl JTAG_SIOCMODE
 */
#define  JTAG_TCK_CYCLE_DELAY_COUNT 2
/*
 * JTAG_CONTROLLER_OUTPUT_DISABLE: JTAG controller mode output disable, it is
 * used to enable other devices to own the JTAG bus.
 * This is bitmask for mode param in jtag_mode for ioctl JTAG_SIOCMODE
 */
#define  JTAG_CONTROLLER_OUTPUT_DISABLE 0
/*
 * JTAG_CONTROLLER_MODE: JTAG controller mode. Used to set JTAG controller in
 * host mode.
 * This is bitmask for mode param in jtag_mode for ioctl JTAG_SIOCMODE
 */
#define  JTAG_CONTROLLER_MODE 1
/*
 * JTAG_XFER_HW_MODE: JTAG hardware mode. Used to set HW drived or bitbang
 * mode. This is bitmask for mode param in jtag_mode for ioctl JTAG_SIOCMODE
 */
#define  JTAG_XFER_HW_MODE 1
/*
 * JTAG_XFER_SW_MODE: JTAG software mode. Used to set SW drived or bitbang
 * mode. This is bitmask for mode param in jtag_mode for ioctl JTAG_SIOCMODE
 */
#define  JTAG_XFER_SW_MODE 0

struct jtag_tap_state {
    uint8_t	reset;
    uint8_t	from;
    uint8_t	endstate;
    uint8_t	tck;
};

struct jtag_xfer {
    uint8_t	type;
    uint8_t	direction;
    uint8_t	from;
    uint8_t	endstate;
    uint32_t	padding;
    uint32_t	length;
    uint64_t	tdio;
};

/**
 * enum jtag_xfer_type:
 *
 * @JTAG_SIR_XFER: SIR transfer
 * @JTAG_SDR_XFER: SDR transfer
 */
enum jtag_xfer_type {
    JTAG_SIR_XFER = 0,
    JTAG_SDR_XFER = 1,
};

/**
 * enum jtag_xfer_direction:
 *
 * @JTAG_READ_XFER: read transfer
 * @JTAG_WRITE_XFER: write transfer
 * @JTAG_READ_WRITE_XFER: read & write transfer
 */
enum jtag_xfer_direction {
    JTAG_READ_XFER = 1,
    JTAG_WRITE_XFER = 2,
    JTAG_READ_WRITE_XFER = 3,
};

/**
 * enum jtag_reset:
 *
 * @JTAG_NO_RESET: JTAG run TAP from current state
 * @JTAG_FORCE_RESET: JTAG force TAP to reset state
 */
enum jtag_reset {
    JTAG_NO_RESET = 0,
    JTAG_FORCE_RESET = 1,
};

/**
 * struct jtag_mode - jtag mode:
 *
 * @feature: 0 - JTAG feature setting selector for JTAG controller HW/SW
 *           1 - JTAG feature setting selector for controller bus mode
 *               output (enable / disable).
 * @mode:    (0 - SW / 1 - HW) for JTAG_XFER_MODE feature(0)
 *           (0 - output disable / 1 - output enable) for JTAG_CONTROL_MODE
 *                                                    feature(1)
 *
 * Structure provide configuration modes to JTAG device.
 */
struct jtag_mode {
	uint32_t	feature;
	uint32_t	mode;
};

/**
 * struct bitbang_packet - jtag bitbang array packet:
 *
 * @data:   JTAG Bitbang struct array pointer(input/output)
 * @length: array size (input)
 *
 * Structure provide interface to JTAG device for JTAG bitbang bundle execution
 */
struct bitbang_packet {
	struct tck_bitbang *data;
	uint32_t	length;
} __attribute__((__packed__));

/**
 * struct jtag_bitbang - jtag bitbang:
 *
 * @tms: JTAG TMS
 * @tdi: JTAG TDI (input)
 * @tdo: JTAG TDO (output)
 *
 * Structure provide interface to JTAG device for JTAG bitbang execution.
 */
struct tck_bitbang {
	uint8_t	tms;
	uint8_t	tdi;
	uint8_t	tdo;
} __attribute__((__packed__));

/**
 * enum jtag_tapstate:
 *
 * @JTAG_STATE_TLRESET: JTAG state machine Test Logic Reset state
 * @JTAG_STATE_IDLE: JTAG state machine IDLE state
 * @JTAG_STATE_SELECTDR: JTAG state machine SELECT_DR state
 * @JTAG_STATE_CAPTUREDR: JTAG state machine CAPTURE_DR state
 * @JTAG_STATE_SHIFTDR: JTAG state machine SHIFT_DR state
 * @JTAG_STATE_EXIT1DR: JTAG state machine EXIT-1 DR state
 * @JTAG_STATE_PAUSEDR: JTAG state machine PAUSE_DR state
 * @JTAG_STATE_EXIT2DR: JTAG state machine EXIT-2 DR state
 * @JTAG_STATE_UPDATEDR: JTAG state machine UPDATE DR state
 * @JTAG_STATE_SELECTIR: JTAG state machine SELECT_IR state
 * @JTAG_STATE_CAPTUREIR: JTAG state machine CAPTURE_IR state
 * @JTAG_STATE_SHIFTIR: JTAG state machine SHIFT_IR state
 * @JTAG_STATE_EXIT1IR: JTAG state machine EXIT-1 IR state
 * @JTAG_STATE_PAUSEIR: JTAG state machine PAUSE_IR state
 * @JTAG_STATE_EXIT2IR: JTAG state machine EXIT-2 IR state
 * @JTAG_STATE_UPDATEIR: JTAG state machine UPDATE IR state
 * @JTAG_STATE_CURRENT: JTAG current state, saved by driver
 */
enum jtag_tapstate {
    JTAG_STATE_TLRESET,
    JTAG_STATE_IDLE,
    JTAG_STATE_SELECTDR,
    JTAG_STATE_CAPTUREDR,
    JTAG_STATE_SHIFTDR,
    JTAG_STATE_EXIT1DR,
    JTAG_STATE_PAUSEDR,
    JTAG_STATE_EXIT2DR,
    JTAG_STATE_UPDATEDR,
    JTAG_STATE_SELECTIR,
    JTAG_STATE_CAPTUREIR,
    JTAG_STATE_SHIFTIR,
    JTAG_STATE_EXIT1IR,
    JTAG_STATE_PAUSEIR,
    JTAG_STATE_EXIT2IR,
    JTAG_STATE_UPDATEIR,
    JTAG_STATE_CURRENT
};

/* ioctl interface */
#define __JTAG_IOCTL_MAGIC	0xb2

#define JTAG_SIOCSTATE	_IOW(__JTAG_IOCTL_MAGIC, 0, struct jtag_tap_state)
#define JTAG_SIOCFREQ	_IOW(__JTAG_IOCTL_MAGIC, 1, unsigned int)
#define JTAG_GIOCFREQ	_IOR(__JTAG_IOCTL_MAGIC, 2, unsigned int)
#define JTAG_IOCXFER	_IOWR(__JTAG_IOCTL_MAGIC, 3, struct jtag_xfer)
#define JTAG_GIOCSTATUS _IOWR(__JTAG_IOCTL_MAGIC, 4, enum jtag_tapstate)
#define JTAG_SIOCMODE	_IOW(__JTAG_IOCTL_MAGIC, 5, unsigned int)
#define JTAG_IOCBITBANG	_IOW(__JTAG_IOCTL_MAGIC, 6, unsigned int)
#define JTAG_SIOCTRST	_IOW(__JTAG_IOCTL_MAGIC, 7, unsigned int)

#define JTAGM_MNT_POINT "/dev/jtag"

#endif //__JTAGM_FS_H
```

## src/uart_fs.c
```c
/*
 * Copyright (c) 2016 Intel Corporation.
 * Copyright 2024 NXP
 *
 * SPDX-License-Identifier: Apache-2.0
 */
#include <stdlib.h>
#include <stdarg.h>
#include <zephyr/fs/fs.h>
#include <zephyr/fs/fs_sys.h>
#include <zephyr/sys/fdtable.h>
#include <zephyr/fs/devfs.h>

static int uart_open(struct fs_file_t *zfp, const char *name, fs_mode_t flags)
{
    printk("open %s.\n", name);
    zfp->filep = "uart close";
    return 0;
}

static int uart_close(struct fs_file_t *zfp)
{
    printk("%s.\n", (char *)zfp->filep);
    return 0;
}

static int uart_ioctl(struct fs_file_t *zfp, unsigned long cmd, va_list args)
{
    switch (cmd)
    {
    case 1:
        printk("uart ioctl %ld.\n", cmd);
        break;
    case 2:
        printk("uart ioctl %ld.\n", cmd);
        break;
    }
    return 0;
}

static const struct fs_file_system_t uart_fs = {
    .open = uart_open,
    .close = uart_close,
    .ioctl = uart_ioctl
};

static int uart_fs_init(void)
{
    devfs_register("/dev/uart1", &uart_fs);
    devfs_register("/dev/uart2", &uart_fs);
    devfs_register("/dev/uart/uart3", &uart_fs);
    return 0;
}

SYS_INIT(uart_fs_init, APPLICATION, CONFIG_FILE_SYSTEM_INIT_PRIORITY);
```
