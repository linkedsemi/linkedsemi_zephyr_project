## CMakeLists.txt
```
# SPDX-License-Identifier: Apache-2.0

cmake_minimum_required(VERSION 3.20.0)
find_package(Zephyr REQUIRED HINTS $ENV{ZEPHYR_BASE})
project(mass)

FILE(GLOB app_sources src/*.c)
target_sources(app PRIVATE ${app_sources})

if(CONFIG_BUILD_WITH_TFM)
  target_include_directories(app PRIVATE
    $<TARGET_PROPERTY:tfm,TFM_BINARY_DIR>/api_ns/interface/include
  )
endif()
```

## prj.conf
```kconfig
CONFIG_USB_DEVICE_STACK_NEXT=y

CONFIG_STDOUT_CONSOLE=y
CONFIG_SERIAL=y
CONFIG_UART_LINE_CTRL=y
CONFIG_USBD_MSC_CLASS=y
CONFIG_USBD_MSC_LUNS_PER_INSTANCE=3

CONFIG_LOG=y
CONFIG_USBD_LOG_LEVEL_WRN=y
CONFIG_UDC_DRIVER_LOG_LEVEL_WRN=y

CONFIG_SAMPLE_USBD_PID=0x0008
CONFIG_SAMPLE_USBD_PRODUCT="USBD MSC sample"
CONFIG_MAIN_STACK_SIZE=2048
CONFIG_SHELL=y
CONFIG_USBD_MSC_INSTANCES_COUNT=2
CONFIG_USBD_MSC_LUNS_PER_INSTANCE=1
CONFIG_FILE_SYSTEM=y
CONFIG_FAT_FILESYSTEM_ELM=y
CONFIG_FILE_SYSTEM_SHELL=y
```

## app.overlay
```dts
/*
 * Copyright (c) 2023 Nordic Semiconductor ASA
 *
 * SPDX-License-Identifier: Apache-2.0
 */

zephyr_udc1: &usb1 {
    status = "okay";
};

/ {
	ramdisk0 {
		compatible = "zephyr,ram-disk";
		disk-name = "USB2";
		sector-size = <512>;
		sector-count = <192>;
	};

	ramdisk1 {
		compatible = "zephyr,ram-disk";
		disk-name = "USB";
		sector-size = <512>;
		sector-count = <192>;
	};
};
```

## src/main.c
```c
/*
 * Copyright (c) 2016 Intel Corporation.
 * Copyright (c) 2019-2020 Nordic Semiconductor ASA
 *
 * SPDX-License-Identifier: Apache-2.0
 */
#include <zephyr/kernel.h>
#include <zephyr/logging/log.h>
#include <zephyr/usb/usb_device.h>
#include <zephyr/usb/usbd.h>
#include <zephyr/usb/class/usbd_msc.h>
#include <zephyr/fs/fs.h>
#include <ff.h>
#include <stdio.h>

LOG_MODULE_REGISTER(main);

static struct fs_mount_t usb2_fs_mnt;
static struct fs_mount_t usb1_fs_mnt;
static FATFS fat_fs_usb2;
static FATFS fat_fs_usb1;

USBD_DEFINE_MSC_LUN(usb2, "USB2", "Zephyr", "RAMDisk", "0.00");
USBD_DEFINE_MSC_LUN(usb1, "USB", "Zephyr", "RAMDisk", "0.00");

extern struct usbd_context *usbd_init_usb2(usbd_msg_cb_t msg_cb);
extern struct usbd_context *usbd_init_usb1(usbd_msg_cb_t msg_cb);

static int enable_usb_device_next(void)
{
	int err;
 	struct usbd_context *usb_ctx = usbd_init_usb2(NULL);
	if (usb_ctx == NULL) {
		LOG_ERR("Failed to initialize USB device");
		return -ENODEV;
	}

	err = usbd_enable(usb_ctx);
	if (err) {
		LOG_ERR("Failed to enable device support");
		return err;
	}

	usb_ctx = usbd_init_usb1(NULL);
	if (usb_ctx == NULL) {
		LOG_ERR("Failed to initialize USB device");
		return -ENODEV;
	}

	err = usbd_enable(usb_ctx);
	if (err) {
		LOG_ERR("Failed to enable device support");
		return err;
	}

	LOG_DBG("USB device support enabled");
	return 0;
}

static void setup_disk(struct fs_mount_t *fs_mnt, FATFS *fat_fs, const char *mnt_point)
{
	struct fs_mount_t *mp = fs_mnt;
	struct fs_dir_t dir;
	struct fs_statvfs sbuf;
	int rc;

	fs_dir_t_init(&dir);

	if (!IS_ENABLED(CONFIG_FILE_SYSTEM_LITTLEFS) &&
	    !IS_ENABLED(CONFIG_FAT_FILESYSTEM_ELM)) {
		LOG_INF("No file system selected");
		return;
	}

	mp->type = FS_FATFS;
	mp->fs_data = fat_fs;
	mp->mnt_point = mnt_point;

	rc = fs_mount(mp);
	if (rc < 0) {
		LOG_ERR("Failed to mount filesystem");
		return;
	}

	/* Allow log messages to flush to avoid interleaved output */
	k_sleep(K_MSEC(50));

	printk("Mount %s: %d\n", mp->mnt_point, rc);

	rc = fs_statvfs(mp->mnt_point, &sbuf);
	if (rc < 0) {
		printk("FAIL: statvfs: %d\n", rc);
		return;
	}

	printk("%s: bsize = %lu ; frsize = %lu ;"
	       " blocks = %lu ; bfree = %lu\n",
	       mp->mnt_point,
	       sbuf.f_bsize, sbuf.f_frsize,
	       sbuf.f_blocks, sbuf.f_bfree);

	rc = fs_opendir(&dir, mp->mnt_point);
	printk("%s opendir: %d\n", mp->mnt_point, rc);

	if (rc < 0) {
		LOG_ERR("Failed to open directory");
	}

	while (rc >= 0) {
		struct fs_dirent ent = { 0 };

		rc = fs_readdir(&dir, &ent);
		if (rc < 0) {
			LOG_ERR("Failed to read directory entries");
			break;
		}
		if (ent.name[0] == 0) {
			printk("End of files\n");
			break;
		}
		printk("  %c %u %s\n",
		       (ent.type == FS_DIR_ENTRY_FILE) ? 'F' : 'D',
		       ent.size,
		       ent.name);
	}

	(void)fs_closedir(&dir);

	return;
}

int main(void)
{
	int ret;

	setup_disk(&usb2_fs_mnt, &fat_fs_usb2, "/usb2:");
	setup_disk(&usb1_fs_mnt, &fat_fs_usb1, "/usb:");

	ret = enable_usb_device_next();

	if (ret != 0) {
		LOG_ERR("Failed to enable USB");
		return 0;
	}

	LOG_INF("The device is put in USB mass storage mode.\n");
	return 0;
}
```

## src/usb_ctx.c
```c
/*
 * Copyright (c) 2023 Nordic Semiconductor ASA
 *
 * SPDX-License-Identifier: Apache-2.0
 */

#include <stdint.h>

#include <zephyr/device.h>
#include <zephyr/usb/usbd.h>
#include <zephyr/usb/bos.h>

#include <zephyr/logging/log.h>
LOG_MODULE_REGISTER(usbd_ctx_config);

#define ZEPHYR_PROJECT_USB_VID		0x2fe3

USBD_DEVICE_DEFINE(USB2,
		   DEVICE_DT_GET(DT_NODELABEL(zephyr_udc0)),
		   ZEPHYR_PROJECT_USB_VID, 0x8);

USBD_DEVICE_DEFINE(USB,
		   DEVICE_DT_GET(DT_NODELABEL(zephyr_udc1)),
		   ZEPHYR_PROJECT_USB_VID, 0x9);

USBD_DESC_LANG_DEFINE(usb2_lang);
USBD_DESC_MANUFACTURER_DEFINE(usb2_mfr, "Zephyr Project");
USBD_DESC_PRODUCT_DEFINE(usb2_product, "usb2.0 msc");
USBD_DESC_SERIAL_NUMBER_DEFINE(usb2_sn);

USBD_DESC_LANG_DEFINE(usb1_lang);
USBD_DESC_MANUFACTURER_DEFINE(usb1_mfr, "Zephyr Project");
USBD_DESC_PRODUCT_DEFINE(usb1_product, "usb1.0 msc");
USBD_DESC_SERIAL_NUMBER_DEFINE(usb1_sn);

/* doc string instantiation end */

USBD_DESC_CONFIG_DEFINE(fs_cfg_desc, "USB Configuration");
USBD_DESC_CONFIG_DEFINE(hs_cfg_desc, "USB2 Configuration");

/* doc configuration instantiation start */
static const uint8_t attributes = (IS_ENABLED(CONFIG_SAMPLE_USBD_SELF_POWERED) ?
				   USB_SCD_SELF_POWERED : 0) |
				  (IS_ENABLED(CONFIG_SAMPLE_USBD_REMOTE_WAKEUP) ?
				   USB_SCD_REMOTE_WAKEUP : 0);

/* Full speed configuration */
USBD_CONFIGURATION_DEFINE(usb1_fs_config,
			  attributes,
			  CONFIG_SAMPLE_USBD_MAX_POWER, &fs_cfg_desc);

/* High speed configuration */
USBD_CONFIGURATION_DEFINE(usb2_hs_config,
			  attributes,
			  CONFIG_SAMPLE_USBD_MAX_POWER, &hs_cfg_desc);

static void sample_fix_code_triple(struct usbd_context *uds_ctx,
				   const enum usbd_speed speed)
{
	/* Always use class code information from Interface Descriptors */
	if (IS_ENABLED(CONFIG_USBD_CDC_ACM_CLASS) ||
	    IS_ENABLED(CONFIG_USBD_CDC_ECM_CLASS) ||
	    IS_ENABLED(CONFIG_USBD_CDC_NCM_CLASS) ||
	    IS_ENABLED(CONFIG_USBD_AUDIO2_CLASS)) {
		/*
		 * Class with multiple interfaces have an Interface
		 * Association Descriptor available, use an appropriate triple
		 * to indicate it.
		 */
		usbd_device_set_code_triple(uds_ctx, speed,
					    USB_BCC_MISCELLANEOUS, 0x02, 0x01);
	} else {
		usbd_device_set_code_triple(uds_ctx, speed, 0, 0, 0);
	}
}

struct usbd_context *usbd_init_usb2(usbd_msg_cb_t msg_cb)
{
	int err;

	/* doc add string descriptor start */
	err = usbd_add_descriptor(&USB2, &usb2_lang);
	if (err) {
		LOG_ERR("Failed to initialize language descriptor (%d)", err);
		return NULL;
	}

	err = usbd_add_descriptor(&USB2, &usb2_mfr);
	if (err) {
		LOG_ERR("Failed to initialize manufacturer descriptor (%d)", err);
		return NULL;
	}

	err = usbd_add_descriptor(&USB2, &usb2_product);
	if (err) {
		LOG_ERR("Failed to initialize product descriptor (%d)", err);
		return NULL;
	}

	err = usbd_add_descriptor(&USB2, &usb2_sn);
	if (err) {
		LOG_ERR("Failed to initialize SN descriptor (%d)", err);
		return NULL;
	}
	/* doc add string descriptor end */

	if (usbd_caps_speed(&USB2) == USBD_SPEED_HS) {
		err = usbd_add_configuration(&USB2, USBD_SPEED_HS,
					     &usb2_hs_config);
		if (err) {
			LOG_ERR("Failed to add High-Speed configuration");
			return NULL;
		}
		usbd_register_class(&USB2, "msc_0", USBD_SPEED_HS, 1);
		sample_fix_code_triple(&USB2, USBD_SPEED_HS);
	}

	if (msg_cb != NULL) {
		/* doc device init-and-msg start */
		err = usbd_msg_register_cb(&USB2, msg_cb);
		if (err) {
			LOG_ERR("Failed to register message callback");
			return NULL;
		}
		/* doc device init-and-msg end */
	}

	/* doc device init start */
	err = usbd_init(&USB2);
	if (err) {
		LOG_ERR("Failed to initialize device support");
		return NULL;
	}
	/* doc device init end */

	return &USB2;
}

struct usbd_context *usbd_init_usb1(usbd_msg_cb_t msg_cb)
{
	int err;

	/* doc add string descriptor start */
	err = usbd_add_descriptor(&USB, &usb1_lang);
	if (err) {
		LOG_ERR("Failed to initialize language descriptor (%d)", err);
		return NULL;
	}

	err = usbd_add_descriptor(&USB, &usb1_mfr);
	if (err) {
		LOG_ERR("Failed to initialize manufacturer descriptor (%d)", err);
		return NULL;
	}

	err = usbd_add_descriptor(&USB, &usb1_product);
	if (err) {
		LOG_ERR("Failed to initialize product descriptor (%d)", err);
		return NULL;
	}

	err = usbd_add_descriptor(&USB, &usb1_sn);
	if (err) {
		LOG_ERR("Failed to initialize SN descriptor (%d)", err);
		return NULL;
	}
	/* doc add string descriptor end */

	err = usbd_add_configuration(&USB, USBD_SPEED_FS,
						&usb1_fs_config);
	if (err) {
		LOG_ERR("Failed to add High-Speed configuration");
		return NULL;
	}
	usbd_register_class(&USB, "msc_1", USBD_SPEED_FS, 1);
	sample_fix_code_triple(&USB, USBD_SPEED_FS);

	if (msg_cb != NULL) {
		/* doc device init-and-msg start */
		err = usbd_msg_register_cb(&USB, msg_cb);
		if (err) {
			LOG_ERR("Failed to register message callback");
			return NULL;
		}
		/* doc device init-and-msg end */
	}

	/* doc device init start */
	err = usbd_init(&USB);
	if (err) {
		LOG_ERR("Failed to initialize device support");
		return NULL;
	}
	/* doc device init end */

	return &USB;
}
```
