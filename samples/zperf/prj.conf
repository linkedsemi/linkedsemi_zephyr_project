## CMakeLists.txt
```
# SPDX-License-Identifier: Apache-2.0

cmake_minimum_required(VERSION 3.20.0)

set(TOOLCHAIN_HAS_NEWLIB y)

find_package(Zephyr REQUIRED HINTS $ENV{ZEPHYR_BASE})
project(zperf)

target_sources(app PRIVATE
  src/main.c
  )

if (CONFIG_NET_SAMPLE_CODE_RELOCATE)
  # Relocate key networking stack components and L2 layer to RAM
  zephyr_code_relocate(LIBRARY subsys__net__ip
    LOCATION "${CONFIG_NET_SAMPLE_CODE_RAM_NAME}_TEXT" NOKEEP)
  zephyr_code_relocate(LIBRARY subsys__net
    LOCATION "${CONFIG_NET_SAMPLE_CODE_RAM_NAME}_TEXT" NOKEEP)
if (CONFIG_NET_L2_ETHERNET)
  zephyr_code_relocate(LIBRARY drivers__ethernet
    LOCATION "${CONFIG_NET_SAMPLE_CODE_RAM_NAME}_TEXT" NOKEEP)
  zephyr_code_relocate(LIBRARY subsys__net__l2__ethernet
    LOCATION "${CONFIG_NET_SAMPLE_CODE_RAM_NAME}_TEXT" NOKEEP)
endif()
endif()

if (CONFIG_USB_DEVICE_STACK_NEXT)
  include(${ZEPHYR_BASE}/samples/subsys/usb/common/common.cmake)
endif()

zephyr_compile_definitions(
    _GNU_SOURCE
    NDEBUG
)
```

## prj.conf
```kconfig
CONFIG_NEWLIB_LIBC=y
CONFIG_NEWLIB_LIBC_MIN_REQUIRED_HEAP_SIZE=0

CONFIG_NETWORKING=y
CONFIG_NET_ZPERF=y
CONFIG_NET_LOG=y
CONFIG_NET_IPV6=n
CONFIG_NET_IPV4=y
CONFIG_NET_DHCPV4=n
CONFIG_NET_UDP=y
CONFIG_NET_TCP=y
CONFIG_NET_TCP_IPV6_ND_REACHABILITY_HINT=y
CONFIG_NET_STATISTICS=y

CONFIG_NET_PKT_RX_COUNT=150
CONFIG_NET_PKT_TX_COUNT=32

CONFIG_NET_BUF_RX_COUNT=150
CONFIG_NET_BUF_TX_COUNT=32

CONFIG_NET_BUF_DATA_SIZE=1600
CONFIG_DWMAC_NB_RX_DESCS=150
CONFIG_DWMAC_NB_TX_DESCS=32

CONFIG_NET_IF_UNICAST_IPV6_ADDR_COUNT=4
CONFIG_NET_IF_MCAST_IPV6_ADDR_COUNT=5
CONFIG_NET_IF_UNICAST_IPV4_ADDR_COUNT=1
CONFIG_NET_MAX_CONTEXTS=5
CONFIG_NET_TC_TX_COUNT=1
CONFIG_NET_SOCKETS=y
CONFIG_NET_SOCKETS_SERVICE_THREAD_PRIO=-1
CONFIG_ZVFS_POLL_MAX=9
# CONFIG_ZVFS_OPEN_MAX=12
# CONFIG_POSIX_API=y

CONFIG_INIT_STACKS=y
CONFIG_TEST_RANDOM_GENERATOR=y

CONFIG_NET_L2_ETHERNET=y
CONFIG_NET_SHELL=y

CONFIG_NET_CONFIG_SETTINGS=y
CONFIG_NET_CONFIG_MY_IPV6_ADDR="2001:db8::1"
CONFIG_NET_CONFIG_PEER_IPV6_ADDR="2001:db8::2"
# CONFIG_NET_CONFIG_MY_IPV4_ADDR="192.0.2.1"
CONFIG_NET_CONFIG_MY_IPV4_ADDR="10.10.20.123"
# CONFIG_NET_CONFIG_PEER_IPV4_ADDR="192.0.2.2"

CONFIG_LOG=y
CONFIG_SHELL_CMDS_RESIZE=n

CONFIG_CACHE_MANAGEMENT=y
CONFIG_SPEED_OPTIMIZATIONS=y
CONFIG_LOG_BUFFER_SIZE=32768

CONFIG_POSIX_TIMERS=n

# CONFIG_XIP=n

CONFIG_THREAD_ANALYZER=y

CONFIG_NET_ZPERF_TCP_RECEIVER_BUF_SIZE=32768
CONFIG_NET_ZPERF_MAX_PACKET_SIZE=32768
```

## boards/lsqsh_evb_cpu1.conf
```kconfig
# CONFIG_IOPMP=n
CONFIG_HW_STACK_PROTECTION=n
CONFIG_PMP_STACK_GUARD_MIN_SIZE=128
# CONFIG_NET_CONFIG_MY_IPV4_ADDR="192.168.1.123"
# CONFIG_NET_CONFIG_MY_IPV4_ADDR="10.10.20.123"
# CONFIG_NET_CONFIG_MY_IPV4_GW="10.10.20.1"
CONFIG_MDIO=y
CONFIG_MDIO_SHELL=n

# CONFIG_COMPILER_OPT="-O3"
CONFIG_THREAD_ANALYZER=y
# CONFIG_NET_PHY_FORCE_100M=y
# CONFIG_NUM_COOP_PRIORITIES=0

CONFIG_NET_TC_THREAD_PRIO_CUSTOM=y
CONFIG_NET_TC_RX_THREAD_BASE_PRIO=5
CONFIG_NET_TC_TX_THREAD_BASE_PRIO=4
# CONFIG_NET_SOCKETS_SERVICE_THREAD_PRIO=6

CONFIG_NET_IPV6=n

# CONFIG_NET_BUF_RX_COUNT=256
# CONFIG_NET_BUF_TX_COUNT=256

# CONFIG_IDLE_STACK_SIZE=2048
CONFIG_MAIN_STACK_SIZE=2048
CONFIG_SHELL_STACK_SIZE=2048
CONFIG_TIMESLICING=y
CONFIG_TIMESLICE_SIZE=0

# CONFIG_COMMON_LIBC_MALLOC=y
# CONFIG_COMMON_LIBC_MALLOC_ARENA_SIZE=32768

# CONFIG_COMMON_LIBC_MALLOC=n
# CONFIG_NEWLIB_LIBC_MALLOC_LSQSH=y
# CONFIG_NEWLIB_LIBC_MALLOC_ARENA_SIZE=32768
```

## boards/lsqsh_evb_cpu1.overlay
```dts
// &chosen {
//     zephyr,flash = &sram;
//     zephyr,sram = &sram;
// };

// &sram {
//     reg = < 0x10000000 DT_SIZE_K(1280) >;
// };
```

## src/main.c
```c
/*
 * Copyright (c) 2020 Nordic Semiconductor ASA
 *
 * SPDX-License-Identifier: Apache-2.0
 */

/**
 * @file
 * @brief Zperf sample.
 */
#include <zephyr/usb/usb_device.h>
#include <zephyr/usb/usbd.h>
#include <zephyr/net/net_config.h>
#include <stdio.h>

#ifdef CONFIG_NET_LOOPBACK_SIMULATE_PACKET_DROP
#include <zephyr/net/loopback.h>
#endif

#if defined(CONFIG_USB_DEVICE_STACK_NEXT)
#include <sample_usbd.h>

static struct usbd_context *sample_usbd;

static int enable_usb_device_next(void)
{
	int err;

	sample_usbd = sample_usbd_init_device(NULL);
	if (sample_usbd == NULL) {
		return -ENODEV;
	}

	err = usbd_enable(sample_usbd);
	if (err) {
		return err;
	}

	return 0;
}
#endif /* CONFIG_USB_DEVICE_STACK_NEXT */

int main(void)
{

#if defined(CONFIG_USB_DEVICE_STACK)
	int ret;

	ret = usb_enable(NULL);
	if (ret != 0) {
		printk("usb enable error %d\n", ret);
	}

	(void)net_config_init_app(NULL, "Initializing network");
#endif /* CONFIG_USB_DEVICE_STACK */

#if defined(CONFIG_USB_DEVICE_STACK_NEXT)
	if (enable_usb_device_next()) {
		return 0;
	}

	(void)net_config_init_app(NULL, "Initializing network");
#endif /* CONFIG_USB_DEVICE_STACK_NEXT */

#ifdef CONFIG_NET_LOOPBACK_SIMULATE_PACKET_DROP
	loopback_set_packet_drop_ratio(1);
#endif

#if defined(CONFIG_NET_DHCPV4) && !defined(CONFIG_NET_CONFIG_SETTINGS)
	net_dhcpv4_start(net_if_get_default());
#endif

	return 0;
}
```
